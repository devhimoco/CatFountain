/*
 ╔══════════════════════════════════════════════════════════╗
 ║        PooKooli Fountain X V2.2  (ESP32-DevKitC)          ║
 ║   V1.0 graduated from the BETA test track after every     ║
 ║   module was verified working individually and together.  ║
 ║   V2.0 was a full redesign: sidebar dashboard web app plus ║
 ║   two new real subsystems — time-of-day Schedule and a     ║
 ║   Recent Activity log.                                     ║
 ║   V2.1 added persistent boot/crash diagnostics — reset     ║
 ║   reason + free heap logged to FLASH every boot (survives  ║
 ║   the crash itself, unlike the RAM activity log), plus a   ║
 ║   min-free-heap tracker, both surfaced on Device Info.      ║
 ║   V2.2 fixes a CONFIRMED crash root cause, found via V2.1's ║
 ║   own boot log: esp_task_wdt_init() was silently failing   ║
 ║   ("already initialized" — newer cores auto-start a        ║
 ║   default watchdog), so our intended 10s timeout never     ║
 ║   actually applied. The I2C auto-recovery sequence then    ║
 ║   outran whatever shorter default WAS active, triggering a ║
 ║   real watchdog panic/reboot mid-recovery. Fixed by         ║
 ║   deiniting any pre-existing watchdog before arming our     ║
 ║   own, plus feeding the watchdog during both the automatic ║
 ║   and manual I2C recovery sequences as defense in depth.    ║
 ║                                                          ║
 ║  VERSIONING:                                             ║
 ║   BETA Vx.y  — test track: +0.1 per module added          ║
 ║   X    Vx.y  — complete edition: +0.1 small, +1.0 big     ║
 ║                                                          ║
 ║   Modules included in this build:                         ║
 ║    ✓ 2× VL53L0X laser sensors (Adafruit lib, XSHUT,       ║
 ║      addr 0x30/0x31), distance range 5–70 cm both         ║
 ║    ✓ Water sensor — real ADC readings, test mode optional ║
 ║    ✓ MOSFET pump (LEDC PWM, 10 power levels)              ║
 ║    ✓ 0.96" OLED (SSD1306) — status + live cm readout      ║
 ║    ✓ Touch sensor (capacitive, active-HIGH) — universal   ║
 ║      manual override: stops any run, or starts a timed    ║
 ║      touch-triggered run                                  ║
 ║    ✓ Web app: sidebar dashboard (Dashboard / Water Tank /  ║
 ║      Pump Control / Schedule / Settings / Device Info /    ║
 ║      Logs) — collapses to a slide-in drawer on phones      ║
 ║    ✓ Schedule: NTP-synced daily trigger times (up to 8),   ║
 ║      persisted to flash, routed through the same           ║
 ║      startPump()/triggerBlocked() path as every other      ║
 ║      trigger source — no separate safety logic             ║
 ║    ✓ Recent Activity log: last 15 events (RAM ring         ║
 ║      buffer, cleared on reboot) — pump start/stop/blocked, ║
 ║      settings saved, system on/off, I2C recovery           ║
 ║    ✓ Device Info page: WiFi/IP/RSSI/MAC, uptime, free      ║
 ║      heap, chip model/rev, firmware version                ║
 ║    ✓ Real photo header + favicon + "Add to Home Screen"   ║
 ║      PWA icon — served directly from the ESP32            ║
 ║    ✓ DEBUG: boot connectivity check + live distances     ║
 ║      shown on the web app AND Serial monitor              ║
 ║    ✓ I2C bus recovery: automatic on sensor dropout, plus  ║
 ║      a manual "Recover I2C Bus" button in the web app     ║
 ║    ✓ Hardware watchdog + NVS-saved settings               ║
 ║    ✓ Laser-triggered pump renews its timer while the cat  ║
 ║      stays in range, instead of stopping mid-drink,       ║
 ║      with a hard 5-minute safety cap regardless           ║
 ║                                                          ║
 ║   NOT included: 433MHz remote (YK04+PT2272-M4) — removed  ║
 ║   during BETA testing after confirmed real electrical     ║
 ║   noise that survived an antenna, a hold filter, and      ║
 ║   dropping the noisiest button. Web app control (WiFi,    ║
 ║   error-checked) proved more robust than RF fighting      ║
 ║   motor EMI.                                              ║
 ╚══════════════════════════════════════════════════════════╝

 ── LIBRARIES  (Arduino Library Manager) ────────────────────
   • Adafruit VL53L0X       — search "VL53L0X" by Adafruit
     (pulls in Adafruit BusIO as a dependency)
   • Adafruit SSD1306        (by Adafruit)
   • Adafruit GFX            (by Adafruit)
   Board: "ESP32 Dev Module"  by Espressif

 ── WIRING ───────────────────────────────────────────────────
  VL53L0X sensor #1:  VCC→3.3V  GND→GND  SDA→GPIO21  SCL→GPIO22
                       XSHUT→GPIO32  (reassigned to addr 0x30 at boot)
  VL53L0X sensor #2:  VCC→3.3V  GND→GND  SDA→GPIO21  SCL→GPIO22
                       XSHUT→GPIO33  (reassigned to addr 0x31 at boot)
  Water level sensor:  GND→GND  +→3.3V  S→GPIO34  (ADC1 ch6)
                       Calibrate WATER_ADC_DRY/WATER_ADC_FULL below to
                       your actual sensor before trusting the % reading
  OLED 0.96" SSD1306:  VCC→3.3V  GND→GND  SDA→GPIO21  SCL→GPIO22
                       (shares I2C bus with both sensors — no extra pins)
  Touch sensor:        VCC→3.3V  GND→GND  SIG→GPIO13
                       (active-HIGH output — no pull-up needed)
  MOSFET module:       Control GND→GND     PWM→GPIO26
 ─────────────────────────────────────────────────────────────
*/

#include <WiFi.h>
#include <WebServer.h>
#include <Preferences.h>
#include <Wire.h>
#include "Adafruit_VL53L0X.h"
#include <Adafruit_GFX.h>
#include <Adafruit_SSD1306.h>
#include <esp_task_wdt.h>
#include <esp_system.h>   // esp_reset_reason() — for persistent boot/crash diagnostics
#include <time.h>   // NTP / wall-clock time-of-day — used only by the Schedule feature

// PooKooli logo — cat photo, 192x192 JPEG, embedded for header/favicon/PWA icon
const uint8_t LOGO_JPG[] PROGMEM = {
  0xFF,0xD8,0xFF,0xE0,0x00,0x10,0x4A,0x46,0x49,0x46,0x00,0x01,0x01,0x00,0x00,0x01,
  0x00,0x01,0x00,0x00,0xFF,0xDB,0x00,0x43,0x00,0x05,0x03,0x04,0x04,0x04,0x03,0x05,
  0x04,0x04,0x04,0x05,0x05,0x05,0x06,0x07,0x0C,0x08,0x07,0x07,0x07,0x07,0x0F,0x0B,
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  0x11,0x7A,0xA6,0x26,0x26,0x26,0x22,0x8B,0xFF,0xD9,
};
const size_t LOGO_JPG_LEN = 13770;

// ── WiFi ─────────────────────────────────────────────────────
const char* WIFI_SSID     = "HiMo 2G";
const char* WIFI_PASSWORD = "@HiMo9226#";

// ── Firmware version ─────────────────────────────────────────
#define FW_VERSION "V2.2"

// ── Time zone (Schedule feature only) ───────────────────────
// Seconds offset from UTC — SET THIS to your local timezone before relying
// on Schedule (e.g. UTC+3:30 = 12600, UTC-5 = -18000). Everything else
// (status, logs, triggers) keeps working even if this is left at 0 — only
// the Schedule page's clock and trigger times depend on it being correct.
const long TZ_OFFSET_SEC = 12600;

// ── GPIO Pins ────────────────────────────────────────────────
#define PIN_XSHUT1      32    // VL53L0X #1 XSHUT (reassigned to 0x30)
#define PIN_XSHUT2      33    // VL53L0X #2 XSHUT (reassigned to 0x31)

// ── Build configuration — attach/detach modules (0 = detached) ─
#define SENSOR2_ATTACHED   1   // laser sensor #2 now wired in
#define WATER_ATTACHED     1   // water sensor now wired in
#define OLED_ATTACHED      1   // 0.96" SSD1306 now wired in
#define PIN_WATER_ADC   34    // Analog water level (ADC1 ch6, input-only)
#define PIN_PUMP        26    // MOSFET PWM
#define PIN_TOUCH       13    // Touch sensor SIG (active-HIGH, driven output)

// ── VL53L0X I²C addresses ────────────────────────────────────
#define VL53_ADDR_1   0x30
#define VL53_ADDR_2   0x31   // real, non-default address — was 0x29 (factory
                             // default) before; that left a bus-collision
                             // window with sensor #1 during boot, which
                             // caused the random detect/error failures

// ── LEDC PWM ─────────────────────────────────────────────────
// ── OLED ─────────────────────────────────────────────────────
#define OLED_WIDTH   128
#define OLED_HEIGHT   32
#define OLED_ADDR    0x3C
#define OLED_RESET     -1
#define OLED_REFRESH_MS 300

#define LEDC_FREQ_HZ    1000
#define LEDC_RESOLUTION   10   // 10-bit: 0–1023

// ── Hardware watchdog ─────────────────────────────────────────
#define WDT_TIMEOUT_SEC 10

// ── Defaults ─────────────────────────────────────────────────
#define DEFAULT_PIR_SEC      60   // pump run time when a laser triggers
#define DEFAULT_WIFI_SEC    120   // pump run time when started from web app
#define DEFAULT_TOUCH_SEC     60   // pump run time when touch sensor triggers
#define DEFAULT_PUMP_POWER    8
#define DEFAULT_DISTANCE1_CM 15
#define DEFAULT_DISTANCE2_CM 15
#define MIN_SEC               5
#define MAX_SEC            3600
#define MIN_DISTANCE_CM       5
#define MAX_DISTANCE_CM      70

// ── Water level ADC calibration ──────────────────────────────
// Adjust to match your sensor's dry/fully-submerged readings.
#define WATER_ADC_DRY    400
#define WATER_ADC_FULL  3000
#define WATER_LOW_PCT     20

// ── Timing constants ─────────────────────────────────────────
#define LASER_LOCKOUT_MS    5000
#define LASER_CONFIRM_MS     150
#define MAX_LASER_RUNTIME_MS (5UL*60UL*1000UL)  // 5 min hard cap — the pump
                                                 // can NEVER run longer than
                                                 // this on laser triggers,
                                                 // no matter how many times
                                                 // the timer renews. Backstop
                                                 // against a stuck-sensor
                                                 // reading falsely showing
                                                 // "cat still present" forever.
#define TOUCH_CONFIRM_MS      60   // clean driven output — no floating-pin noise
#define TOUCH_DEBOUNCE_MS    500   // cooldown before a new touch is accepted
#define EMPTY_BLINK_MS      3000
#define WATER_SAMPLE_MS     2000
#define DIST_SAMPLE_MS       120   // refresh cached laser distances
#define DIST_PRINT_MS       2000   // Serial distance report interval

// ── Globals ──────────────────────────────────────────────────
WebServer         server(80);
Adafruit_SSD1306  oled(OLED_WIDTH, OLED_HEIGHT, &Wire, OLED_RESET);
unsigned long     lastOledUpdate = 0;
Preferences       prefs;
Adafruit_VL53L0X  sensor1 = Adafruit_VL53L0X();
Adafruit_VL53L0X  sensor2 = Adafruit_VL53L0X();
VL53L0X_RangingMeasurementData_t measure1, measure2;
bool              tof1Ok = false, tof2Ok = false;

unsigned long pirDurationMs    = DEFAULT_PIR_SEC    * 1000UL;
unsigned long wifiDurationMs   = DEFAULT_WIFI_SEC   * 1000UL;
unsigned long touchDurationMs  = DEFAULT_TOUCH_SEC   * 1000UL;
uint8_t       pumpPower        = DEFAULT_PUMP_POWER;
uint8_t       triggerDistance1Cm = DEFAULT_DISTANCE1_CM;
uint8_t       triggerDistance2Cm = DEFAULT_DISTANCE2_CM;

bool          systemEnabled    = true;
bool          touchEnabled     = true;
bool          laser1Enabled    = true;
bool          laser2Enabled    = true;

enum PumpSource { SRC_NONE, SRC_PIR, SRC_WIFI, SRC_TOUCH, SRC_SCHED };

bool          pumpRunning    = false;
bool          pumpContinuous = false;
PumpSource    pumpSource     = SRC_NONE;
unsigned long pumpStartTime  = 0;
unsigned long pumpDuration   = 0;
bool          tankLowError   = false;
unsigned long emptyErrorTime = 0;

int           waterPct       = 100;
unsigned long lastWaterRead  = 0;

// Test / debug
bool          testMode       = !WATER_ATTACHED; // water detached: defaults ON (50%)
long          lastDist1Cm    = -1;     // latest cached readings (cm), -1 = none
long          lastDist2Cm    = -1;
unsigned long lastDistRead   = 0;
unsigned long lastDistPrint  = 0;

bool          laserCandidate      = false;
unsigned long laserCandidateSince = 0;
unsigned long lastLaserEndTime    = 0;
unsigned long laserFirstTriggerTime = 0;  // set on the FIRST trigger of a
                                           // renewal chain, never touched by
                                           // renewals themselves — used to
                                           // enforce MAX_LASER_RUNTIME_MS

// Touch debounce state
bool          touchCandidate      = false;
unsigned long touchCandidateSince = 0;
unsigned long lastTouchTime       = 0;

// RF remote edge-detection state — one entry per button (A,B,C,D)

// ── Schedule (time-of-day triggers) ─────────────────────────
// Needs NTP — see TZ_OFFSET_SEC above. Persisted to NVS as a raw struct
// blob, same "fountain" namespace as every other saved setting.
#define MAX_SCHEDULES 8
struct ScheduleEntry {
  uint8_t  hour;         // 0-23
  uint8_t  minute;       // 0-59
  uint16_t durationSec;  // MIN_SEC..MAX_SEC
  bool     enabled;
  bool     firedToday;   // reset at local-midnight rollover, not persisted
};
ScheduleEntry schedules[MAX_SCHEDULES];
uint8_t       scheduleCount   = 0;
int           lastScheduleDay = -1;   // tm_yday of the last rollover check
bool          timeSynced      = false;

// ── Recent activity log (RAM ring buffer, cleared on reboot) ─
#define MAX_LOG_ENTRIES 15
struct LogEntry { unsigned long ms; String msg; };
LogEntry eventLog[MAX_LOG_ENTRIES];
uint8_t  logHead  = 0;
uint8_t  logCount = 0;
void logEvent(const String &msg) {
  eventLog[logHead] = { millis(), msg };
  logHead = (logHead + 1) % MAX_LOG_ENTRIES;
  if (logCount < MAX_LOG_ENTRIES) logCount++;
}

// ── Persistent boot/crash history (survives every reset type) ──
// Unlike the RAM activity log above (wiped by the very reset we're
// trying to diagnose), this is written to flash at the start of every
// boot — including right after a brownout or watchdog reset — so it
// survives exactly the events we need to see. Kept deliberately small
// (10 entries × 5 bytes) since NVS gets a real write every single boot;
// a crash-loop scenario could write fairly often, so this stays tiny
// and simple rather than anything heavier.
#define MAX_BOOT_HISTORY 10
struct BootRecord {
  uint8_t  reason;         // esp_reset_reason_t value
  uint32_t freeHeapAtBoot; // bytes
};
BootRecord bootHistory[MAX_BOOT_HISTORY];
uint8_t    bootHistoryCount = 0;
uint32_t   minFreeHeapSeen  = UINT32_MAX;   // lowest free heap seen THIS session

const char* resetReasonStr(uint8_t r) {
  switch ((esp_reset_reason_t)r) {
    case ESP_RST_POWERON:   return "Power-on";
    case ESP_RST_EXT:       return "External reset";
    case ESP_RST_SW:        return "Software (restart button)";
    case ESP_RST_PANIC:     return "PANIC (crash)";
    case ESP_RST_INT_WDT:   return "Interrupt watchdog";
    case ESP_RST_TASK_WDT:  return "Task watchdog";
    case ESP_RST_WDT:       return "Other watchdog";
    case ESP_RST_BROWNOUT:  return "BROWNOUT (power dip)";
    case ESP_RST_SDIO:      return "SDIO";
    case ESP_RST_DEEPSLEEP: return "Deep sleep wake";
    default:                return "Unknown";
  }
}

void loadBootHistory() {
  prefs.begin("fountain", true);
  bootHistoryCount = prefs.getUChar("boot_n", 0);
  if (bootHistoryCount > MAX_BOOT_HISTORY) bootHistoryCount = MAX_BOOT_HISTORY;
  size_t len = prefs.getBytes("boot_hist", bootHistory, sizeof(bootHistory));
  if (len != sizeof(bootHistory)) { bootHistoryCount = 0; memset(bootHistory, 0, sizeof(bootHistory)); }
  prefs.end();
}

// Records THIS boot's reset reason, shifting older entries down (index 0
// = most recent). Called once, very early in setup().
void recordBootReason() {
  loadBootHistory();
  esp_reset_reason_t reason = esp_reset_reason();

  int keep = (bootHistoryCount < MAX_BOOT_HISTORY) ? bootHistoryCount : (MAX_BOOT_HISTORY - 1);
  for (int i = keep - 1; i >= 0; i--) bootHistory[i + 1] = bootHistory[i];
  bootHistory[0] = { (uint8_t)reason, (uint32_t)ESP.getFreeHeap() };
  if (bootHistoryCount < MAX_BOOT_HISTORY) bootHistoryCount++;

  prefs.begin("fountain", false);
  prefs.putUChar("boot_n", bootHistoryCount);
  prefs.putBytes("boot_hist", bootHistory, sizeof(bootHistory));
  prefs.end();

  Serial.printf("[Boot] Reason: %s | Free heap: %u bytes\n", resetReasonStr(reason), ESP.getFreeHeap());
}

String buildBootHistoryJson() {
  String j = "[";
  for (uint8_t i = 0; i < bootHistoryCount; i++) {
    if (i) j += ",";
    j += "{\"reason\":\"" + String(resetReasonStr(bootHistory[i].reason)) + "\","
       + "\"heap_kb\":" + String(bootHistory[i].freeHeapAtBoot / 1024) + "}";
  }
  j += "]";
  return j;
}

// ── NVS ──────────────────────────────────────────────────────
void loadSettings() {
  prefs.begin("fountain", true);
  pirDurationMs      = prefs.getULong("pir_ms",   DEFAULT_PIR_SEC    * 1000UL);
  wifiDurationMs     = prefs.getULong("wifi_ms",  DEFAULT_WIFI_SEC   * 1000UL);
  touchDurationMs    = prefs.getULong("touch_ms", DEFAULT_TOUCH_SEC  * 1000UL);
  pumpPower          = prefs.getUChar("pump_pwr", DEFAULT_PUMP_POWER);
  if (pumpPower < 1 || pumpPower > 10) pumpPower = DEFAULT_PUMP_POWER;
  triggerDistance1Cm = prefs.getUChar("dist1_cm", DEFAULT_DISTANCE1_CM);
  triggerDistance2Cm = prefs.getUChar("dist2_cm", DEFAULT_DISTANCE2_CM);
  if (triggerDistance1Cm < MIN_DISTANCE_CM || triggerDistance1Cm > MAX_DISTANCE_CM)
    triggerDistance1Cm = DEFAULT_DISTANCE1_CM;
  if (triggerDistance2Cm < MIN_DISTANCE_CM || triggerDistance2Cm > MAX_DISTANCE_CM)
    triggerDistance2Cm = DEFAULT_DISTANCE2_CM;
  systemEnabled = prefs.getBool("sys_en",    true);
  laser1Enabled = prefs.getBool("laser1_en", true);
  laser2Enabled = prefs.getBool("laser2_en", true);
  touchEnabled  = prefs.getBool("touch_en",  true);
  scheduleCount = prefs.getUChar("sched_n", 0);
  if (scheduleCount > MAX_SCHEDULES) scheduleCount = MAX_SCHEDULES;
  size_t schedLen = prefs.getBytes("sched", schedules, sizeof(schedules));
  if (schedLen != sizeof(schedules)) {   // no/mismatched blob saved yet — start empty
    scheduleCount = 0;
    memset(schedules, 0, sizeof(schedules));
  }
  for (uint8_t i = 0; i < MAX_SCHEDULES; i++) schedules[i].firedToday = false;
  prefs.end();
  Serial.printf("[NVS] pir=%lus wifi=%lus touch=%lus pwr=%d d1=%dcm d2=%dcm sys=%d l1=%d l2=%d touch_en=%d sched_n=%d\n",
    pirDurationMs/1000, wifiDurationMs/1000, touchDurationMs/1000, pumpPower,
    triggerDistance1Cm, triggerDistance2Cm, systemEnabled, laser1Enabled, laser2Enabled, touchEnabled, scheduleCount);
}
void saveSettings() {
  prefs.begin("fountain", false);
  prefs.putULong("pir_ms",   pirDurationMs);
  prefs.putULong("wifi_ms",  wifiDurationMs);
  prefs.putULong("touch_ms", touchDurationMs);
  prefs.putUChar("pump_pwr", pumpPower);
  prefs.putUChar("dist1_cm", triggerDistance1Cm);
  prefs.putUChar("dist2_cm", triggerDistance2Cm);
  prefs.putBool("sys_en",    systemEnabled);
  prefs.putBool("laser1_en", laser1Enabled);
  prefs.putBool("laser2_en", laser2Enabled);
  prefs.putBool("touch_en",  touchEnabled);
  prefs.putUChar("sched_n",  scheduleCount);
  prefs.putBytes("sched",    schedules, sizeof(schedules));
  prefs.end();
  Serial.println("[NVS] Saved");
}

// ── Water level ──────────────────────────────────────────────
void readWaterLevel() {
  if (!WATER_ATTACHED) {          // sensor not wired: locked at 50%, no ADC read
    waterPct = 50;
    return;
  }
  if (testMode) {                 // TEST MODE: pretend the tank is half full
    waterPct = 50;
    Serial.println("[Water] TEST MODE — forced to 50%");
    return;
  }
  int raw = analogRead(PIN_WATER_ADC);
  raw = constrain(raw, WATER_ADC_DRY, WATER_ADC_FULL);
  waterPct = map(raw, WATER_ADC_DRY, WATER_ADC_FULL, 0, 100);
  Serial.printf("[Water] raw=%d  pct=%d%%\n", raw, waterPct);
}
bool hasWater() { return waterPct >= WATER_LOW_PCT; }

// ── Distance sampling ─────────────────────────────────────────
// One cached read per sensor, refreshed every DIST_SAMPLE_MS in loop().
// Used by the trigger logic, the web app JSON, and the Serial report —
// so the sensor is read in exactly ONE place.
// Uses rangingTest() — a single on-demand ranging call, matching the
// Adafruit_VL53L0X reference sketch that tested reliable on this hardware.
long readOneCm(Adafruit_VL53L0X &sensor, VL53L0X_RangingMeasurementData_t &measure, bool okFlag) {
  if (!okFlag) return -1;
  sensor.rangingTest(&measure, false);
  if (measure.RangeStatus == 4) return -1;   // 4 = out of range / invalid
  return (long)(measure.RangeMilliMeter / 10);
}
// Lightweight connectivity check — verifies the sensor still ACKs its
// I2C address, independent of whatever rangingTest() last returned.
// This matters because rangingTest() doesn't report success/failure:
// if a transaction gets corrupted by motor/PWM noise, the measurement
// struct can be left holding stale data from the last GOOD read —
// which is exactly how a sensor can appear "stuck" reporting the same
// in-range distance forever, or stop updating entirely.
bool i2cPing(uint8_t addr) {
  Wire.beginTransmission(addr);
  return (Wire.endTransmission() == 0);
}

// Require several consecutive failed pings before treating a sensor as
// actually lost. A single missed ping under normal pump PWM noise is
// routine and should be silently ignored — reacting to it immediately
// was causing a real regression: the pump would fully stop and hit the
// 5s anti-chatter lockout even though the cat never left, because one
// transient blip zeroed the distance reading for that instant. 3
// consecutive misses (~360ms at the 120ms sample rate) still catches a
// genuinely stuck sensor fast, without overreacting to routine noise.
#define SENSOR_FAIL_THRESHOLD 3
uint8_t sensor1FailCount = 0;
uint8_t sensor2FailCount = 0;

void readDistances() {
  bool ping1Ok = !tof1Ok || i2cPing(VL53_ADDR_1);
  bool ping2Ok = !tof2Ok || !SENSOR2_ATTACHED || i2cPing(VL53_ADDR_2);

  if (ping1Ok) sensor1FailCount = 0;
  else if (sensor1FailCount < 255) sensor1FailCount++;
  if (ping2Ok) sensor2FailCount = 0;
  else if (sensor2FailCount < 255) sensor2FailCount++;

  if (tof1Ok && sensor1FailCount >= SENSOR_FAIL_THRESHOLD) {
    Serial.println("[VL53L0X] Sensor #1 stopped ACKing — will attempt recovery");
    tof1Ok = false;
  }
  if (tof2Ok && SENSOR2_ATTACHED && sensor2FailCount >= SENSOR_FAIL_THRESHOLD) {
    Serial.println("[VL53L0X] Sensor #2 stopped ACKing — will attempt recovery");
    tof2Ok = false;
  }

  lastDist1Cm = readOneCm(sensor1, measure1, tof1Ok);
  lastDist2Cm = readOneCm(sensor2, measure2, tof2Ok);

  // Self-heal: a dropped-out sensor gets the same full bus recovery +
  // re-init as the web app's manual button, automatically. Throttled
  // so a persistent noise source doesn't hammer retries constantly.
  static unsigned long lastAutoRecover = 0;
  bool needRecover = (!tof1Ok) || (SENSOR2_ATTACHED && !tof2Ok);
  if (needRecover && (millis() - lastAutoRecover > 3000)) {
    lastAutoRecover = millis();
    Serial.println("[Recovery] Auto-recovering I2C bus after sensor dropout");
    esp_task_wdt_reset();   // this sequence can run long if the bus is
    Wire.end();             // genuinely unwell — feed the watchdog before
    recoverI2CBus(21, 22);  // AND after so a slow recovery can never
    Wire.begin(21, 22);     // itself trigger a false panic/reboot
    Wire.setClock(100000);
    delay(50);
    initI2CDevices();
    esp_task_wdt_reset();
  }
}

// ── Debounced dual-laser check (uses cached distances) ───────
bool laserStable() {
  if (!laser1Enabled && !laser2Enabled) { laserCandidate = false; return false; }
  bool raw = false;
  if (laser1Enabled && lastDist1Cm > 0 && lastDist1Cm <= (long)triggerDistance1Cm) raw = true;
  if (!raw && laser2Enabled && lastDist2Cm > 0 && lastDist2Cm <= (long)triggerDistance2Cm) raw = true;
  if (raw != laserCandidate) {
    laserCandidate      = raw;
    laserCandidateSince = millis();
  }
  return raw && (millis() - laserCandidateSince >= LASER_CONFIRM_MS);
}

// ── Instant presence check (no debounce) — used to decide whether to
// renew a running laser-triggered pump timer instead of stopping it.
// laserStable()'s debounce state is only updated while NOT pumpRunning,
// so it can't be reused here; this reads the same cached distances
// directly against each sensor's own threshold.
bool catStillPresent() {
  if (!laser1Enabled && !laser2Enabled) return false;
  if (laser1Enabled && lastDist1Cm > 0 && lastDist1Cm <= (long)triggerDistance1Cm) return true;
  if (laser2Enabled && lastDist2Cm > 0 && lastDist2Cm <= (long)triggerDistance2Cm) return true;
  return false;
}

// ── Debounced touch check ─────────────────────────────────────
// Touch module drives SIG actively (push-pull, not floating), so a
// short confirm window is enough — no noise-flicker risk like an
// unconnected mechanical pin would have.
bool touchStable() {
  if (!touchEnabled) { touchCandidate = false; return false; }
  bool raw = (digitalRead(PIN_TOUCH) == HIGH);
  if (raw != touchCandidate) {
    touchCandidate      = raw;
    touchCandidateSince = millis();
  }
  return raw && (millis() - touchCandidateSince >= TOUCH_CONFIRM_MS);
}

// ── Pump control ─────────────────────────────────────────────
void pumpON() {
  int pwmVal = map((int)pumpPower, 1, 10, 100, 1023);
  ledcWrite(PIN_PUMP, pwmVal);
}
void pumpOFF() {
  ledcWrite(PIN_PUMP, 0);
  pumpRunning = false; pumpContinuous = false; pumpSource = SRC_NONE;
}
void triggerBlocked(PumpSource src) {
  tankLowError = true; emptyErrorTime = millis();
  Serial.printf("[Pump] BLOCKED src=%d water=%d%%\n", src, waterPct);
}
void startPump(PumpSource src, unsigned long dur) {
  tankLowError = false; pumpRunning = true; pumpContinuous = false;
  pumpSource = src; pumpStartTime = millis(); pumpDuration = dur;
  pumpON();
  Serial.printf("[Pump] ON src=%d dur=%lus pwr=%d\n", src, dur/1000, pumpPower);
}
void startPumpForever(PumpSource src) {
  tankLowError = false; pumpRunning = true; pumpContinuous = true;
  pumpSource = src; pumpStartTime = millis(); pumpDuration = 0;
  pumpON();
  Serial.printf("[Pump] CONTINUOUS src=%d pwr=%d\n", src, pumpPower);
}

// ── OLED display ────────────────────────────────────────────
void drawBar(int x, int y, int w, int h, int pct) {
  oled.drawRect(x, y, w, h, SSD1306_WHITE);
  int fill = (w - 2) * constrain(pct, 0, 100) / 100;
  if (fill > 0) oled.fillRect(x+1, y+1, fill, h-2, SSD1306_WHITE);
}

void updateOled() {
  if (!OLED_ATTACHED) return;
  oled.clearDisplay();
  oled.setTextColor(SSD1306_WHITE);
  oled.setTextWrap(false);
  oled.setTextSize(1);

  if (tankLowError) {
    oled.setCursor(0,  0); oled.print(F("!! WATER LOW !!"));
    char buf[18]; snprintf(buf, sizeof(buf), "Level: %d%%", waterPct);
    oled.setCursor(0, 11); oled.print(buf);
    oled.setCursor(0, 22); oled.print(F("Refill reservoir"));
    oled.display(); return;
  }

  if (!systemEnabled) {
    oled.setCursor(0,  0); oled.print(F("PooKooli X"));
    oled.setCursor(0, 12); oled.print(F("SYSTEM OFF"));
    oled.setCursor(0, 24); oled.print(F("Enable in web app"));
    oled.display(); return;
  }

  if (pumpRunning) {
    const char* who = (pumpSource==SRC_PIR) ? "Laser" : (pumpSource==SRC_TOUCH) ? "Touch" : (pumpSource==SRC_SCHED) ? "Sched" : "App";
    char row0[22]; snprintf(row0, sizeof(row0), "%s  Pwr:%d/10", who, pumpPower);
    oled.setCursor(0, 0); oled.print(row0);
    if (pumpContinuous) {
      unsigned long el = (millis()-pumpStartTime)/1000;
      char buf[14]; snprintf(buf, sizeof(buf), "~%02lu:%02lu~", el/60, el%60);
      oled.setTextSize(2); oled.setCursor(16, 14); oled.print(buf);
    } else {
      unsigned long el  = millis()-pumpStartTime;
      unsigned long rem = (el>=pumpDuration)?0:(pumpDuration-el);
      char buf[6]; snprintf(buf, sizeof(buf), "%02lu:%02lu", rem/1000/60, (rem/1000)%60);
      oled.setTextSize(2);
      int x = (OLED_WIDTH-(int)strlen(buf)*12)/2;
      oled.setCursor(max(0,x), 14); oled.print(buf);
    }
    oled.display(); return;
  }

  // Idle — debug-focused: IP, live sensor distances, water bar
  oled.setCursor(0, 0);
  if (WiFi.status()==WL_CONNECTED) oled.print(WiFi.localIP().toString());
  else                              oled.print(F("No WiFi"));

  char distLine[22];
  char d1[8], d2[8];
  if (!tof1Ok)                strcpy(d1, "ERR");
  else if (lastDist1Cm >= 0)  snprintf(d1, sizeof(d1), "%ld", lastDist1Cm);
  else                        strcpy(d1, "--");
  if (!SENSOR2_ATTACHED)      strcpy(d2, "--");
  else if (!tof2Ok)           strcpy(d2, "ERR");
  else if (lastDist2Cm >= 0)  snprintf(d2, sizeof(d2), "%ld", lastDist2Cm);
  else                        strcpy(d2, "--");
  snprintf(distLine, sizeof(distLine), "S1:%scm S2:%scm", d1, d2);
  oled.setCursor(0, 11); oled.print(distLine);

  char wbuf[10]; snprintf(wbuf, sizeof(wbuf), "W:%d%%", waterPct);
  oled.setCursor(0, 23); oled.print(wbuf);
  drawBar(34, 23, 76, 8, waterPct);
  oled.display();
}

// ── JSON status ──────────────────────────────────────────────
String srcStr() {
  switch (pumpSource) {
    case SRC_PIR:    return "PIR";
    case SRC_WIFI:   return "WIFI";
    case SRC_TOUCH:  return "TOUCH";
    case SRC_SCHED:  return "SCHED";
    default:       return "NONE";
  }
}
String buildStatusJson() {
  unsigned long el = pumpRunning ? (millis()-pumpStartTime) : 0;
  String j = "{";
  j += "\"running\":"        + String(pumpRunning    ?"true":"false") + ",";
  j += "\"continuous\":"     + String(pumpContinuous ?"true":"false") + ",";
  j += "\"empty_error\":"    + String(tankLowError   ?"true":"false") + ",";
  j += "\"locked\":"         + String((pumpRunning&&pumpSource!=SRC_WIFI)?"true":"false") + ",";
  j += "\"source\":\""       + srcStr() + "\",";
  j += "\"water\":"          + String(hasWater()?"true":"false") + ",";
  j += "\"water_pct\":"      + String(waterPct) + ",";
  j += "\"elapsed_ms\":"     + String(el) + ",";
  j += "\"duration_ms\":"    + String(pumpDuration) + ",";
  j += "\"pir_sec\":"        + String(pirDurationMs/1000) + ",";
  j += "\"touch_sec\":"      + String(touchDurationMs/1000) + ",";
  j += "\"wifi_sec\":"       + String(wifiDurationMs/1000) + ",";
  j += "\"pump_power\":"     + String(pumpPower) + ",";
  j += "\"distance1_cm\":"   + String(triggerDistance1Cm) + ",";
  j += "\"distance2_cm\":"   + String(triggerDistance2Cm) + ",";
  j += "\"live_dist1_cm\":"  + String(lastDist1Cm) + ",";
  j += "\"live_dist2_cm\":"  + String(lastDist2Cm) + ",";
  j += "\"sensor1_ok\":"     + String(tof1Ok?"true":"false") + ",";
  j += "\"sensor2_ok\":"     + String(tof2Ok?"true":"false") + ",";
  j += "\"sensor2_attached\":" + String(SENSOR2_ATTACHED?"true":"false") + ",";
  j += "\"water_attached\":" + String(WATER_ATTACHED?"true":"false") + ",";
  j += "\"test_mode\":"      + String(testMode?"true":"false") + ",";
  j += "\"system_enabled\":" + String(systemEnabled?"true":"false") + ",";
  j += "\"laser1_enabled\":" + String(laser1Enabled?"true":"false") + ",";
  j += "\"laser2_enabled\":" + String(laser2Enabled?"true":"false") + ",";
  j += "\"touch_enabled\":"  + String(touchEnabled?"true":"false");
  j += "}";
  return j;
}

// ── Web page ──────────────────────────────────────────────────
const char INDEX_HTML[] PROGMEM = R"rawliteral(
<!DOCTYPE html>
<html lang="en">
<head>
<meta charset="UTF-8">
<meta name="viewport" content="width=device-width,initial-scale=1,maximum-scale=1">
<title>PooKooli Fountain</title>
<meta name="theme-color" content="#0a0c12">
<link rel="icon" type="image/jpeg" href="/logo.jpg">
<link rel="apple-touch-icon" href="/logo.jpg">
<link rel="manifest" href="/manifest.json">
<style>
*{margin:0;padding:0;box-sizing:border-box;-webkit-tap-highlight-color:transparent}
:root{--bg:#0a0c12;--side-bg:#0d1119;--card:#12161f;--card2:#161c28;--line:#212838;
  --ink:#eef2f8;--ink-soft:#93a0b8;--ink-faint:#566178;
  --cyan:#22d3ee;--cyan2:#0891b2;--violet:#a78bfa;
  --on:#34d399;--off:#fb7185;--warn:#fbbf24;--radius:18px}
*{-webkit-tap-highlight-color:transparent}
html,body{height:100%}
body{font-family:-apple-system,BlinkMacSystemFont,"Segoe UI",Roboto,system-ui,sans-serif;
  background:var(--bg);color:var(--ink);overflow-x:hidden;
  background-image:radial-gradient(circle at 85% 0%,rgba(34,211,238,.07),transparent 55%)}
h1,h2,h3{font-weight:800;letter-spacing:-.02em}
.app{display:flex;min-height:100vh}

/* ── Sidebar ─────────────────────────────────────────────── */
.sidebar{position:fixed;top:0;left:0;bottom:0;width:252px;background:var(--side-bg);
  border-right:1px solid var(--line);display:flex;flex-direction:column;z-index:40;
  transition:transform .25s ease}
.side-brand{display:flex;align-items:center;gap:12px;padding:24px 18px 20px}
.brand-mark{width:44px;height:44px;border-radius:50%;overflow:hidden;flex-shrink:0;
  box-shadow:0 0 0 2px var(--side-bg),0 0 0 3px rgba(34,211,238,.45),0 4px 14px rgba(0,0,0,.4)}
.side-logo{width:100%;height:100%;object-fit:cover;display:block}
.brand-word{min-width:0}
.brand-line1{font-family:inherit;font-size:1.05rem;font-weight:800;letter-spacing:-.01em;color:var(--ink);line-height:1.15}
.brand-line1 .accent{color:var(--cyan)}
.brand-line2{font-size:.62rem;font-weight:800;letter-spacing:.18em;color:var(--ink-faint);margin-top:3px}
.brand-line2 .accent{color:var(--cyan)}
.side-nav{flex:1;padding:8px 12px;overflow-y:auto}
.nav-item{width:100%;display:flex;align-items:center;gap:12px;padding:11px 12px;border:none;background:none;
  color:var(--ink-soft);font-family:inherit;font-size:.85rem;font-weight:600;border-radius:11px;cursor:pointer;
  text-align:left;margin-bottom:2px;position:relative;transition:background .15s,color .15s}
.nav-item svg{width:18px;height:18px;flex-shrink:0;stroke:currentColor}
.nav-item:hover{background:rgba(255,255,255,.03);color:var(--ink)}
.nav-item.active{background:rgba(34,211,238,.1);color:var(--cyan)}
.nav-item.active::before{content:"";position:absolute;left:-12px;top:8px;bottom:8px;width:3px;border-radius:0 3px 3px 0;background:var(--cyan)}
.side-foot{padding:14px 18px 20px;border-top:1px solid var(--line)}
.side-status{display:flex;align-items:center;gap:8px;font-size:.76rem;font-weight:600;color:var(--ink-soft)}
.dot-sm{width:7px;height:7px;border-radius:50%;background:var(--on);box-shadow:0 0 6px var(--on)}
.dot-sm.bad{background:var(--off);box-shadow:0 0 6px var(--off)}
.side-fw{font-size:.66rem;color:var(--ink-faint);margin-top:6px;font-weight:600;font-variant-numeric:tabular-nums}
.scrim{display:none;position:fixed;inset:0;background:rgba(0,0,0,.5);z-index:35}
.scrim.show{display:block}

/* ── Main ────────────────────────────────────────────────── */
.main{flex:1;margin-left:252px;min-height:100vh;padding:0 26px 60px;max-width:900px}
.topbar{position:sticky;top:0;background:var(--bg);z-index:20;display:flex;align-items:center;gap:14px;
  padding:20px 0 16px;border-bottom:1px solid var(--line);margin-bottom:22px}
.hamburger{display:none;width:42px;height:42px;border-radius:11px;border:1px solid var(--line);background:var(--card);
  color:var(--cyan);align-items:center;justify-content:center;cursor:pointer;flex-shrink:0}
.hamburger:active{background:rgba(34,211,238,.1)}
.hamburger svg{width:19px;height:19px}
.topbar-title{font-size:1.15rem;font-weight:800;flex-shrink:0}
.topbar-right{display:flex;align-items:center;gap:8px;margin-left:auto;flex-wrap:wrap;justify-content:flex-end}
.tb-chip{font-size:.72rem;font-weight:700;padding:6px 11px;border-radius:99px;background:var(--card);
  border:1px solid var(--line);color:var(--ink-soft);white-space:nowrap;font-variant-numeric:tabular-nums}
.icon-btn{width:36px;height:36px;border-radius:10px;border:1px solid var(--line);background:var(--card);
  display:flex;align-items:center;justify-content:center;cursor:pointer;flex-shrink:0}
.icon-btn svg{width:16px;height:16px;stroke:var(--ink-soft)}
#btnSystemIcon.state-on svg{stroke:var(--on)}
#btnSystemIcon.state-off svg{stroke:var(--off)}
#btnRestartIcon svg{stroke:var(--cyan)}
@keyframes spin{from{transform:rotate(0deg)}to{transform:rotate(360deg)}}
.icon-btn.spinning svg{animation:spin .9s linear infinite}

.page{display:none}
.page.active{display:block}

/* ── Banners ─────────────────────────────────────────────── */
.error-banner{display:none;background:rgba(251,113,133,.1);border:1px solid rgba(251,113,133,.3);border-radius:14px;
  padding:14px 16px;margin-bottom:18px;align-items:center;gap:12px}
.error-banner.show{display:flex}
.error-ico{font-size:1.8rem;flex-shrink:0}
.error-title{font-size:.95rem;font-weight:800;color:var(--off)}
.error-msg{font-size:.78rem;color:var(--ink-soft);margin-top:2px}
.master-off-banner{display:none;background:rgba(251,113,133,.08);border:1px solid rgba(251,113,133,.25);border-radius:14px;
  padding:12px 16px;margin-bottom:18px;font-size:.82rem;color:var(--ink-soft);align-items:center;gap:10px}
.master-off-banner.show{display:flex}
.sync-banner{display:none;background:rgba(251,191,36,.08);border:1px solid rgba(251,191,36,.3);border-radius:14px;
  padding:12px 16px;margin-bottom:18px;font-size:.82rem;color:var(--warn);align-items:center;gap:10px}
.sync-banner.show{display:flex}

/* ── Grid + cards ────────────────────────────────────────── */
.grid-2{display:grid;grid-template-columns:1fr 1fr;gap:16px}
.grid-3{display:grid;grid-template-columns:repeat(3,1fr);gap:14px}
.grid-4{display:grid;grid-template-columns:repeat(4,1fr);gap:14px}
.section-title{font-size:.66rem;font-weight:800;letter-spacing:.14em;text-transform:uppercase;color:var(--ink-faint);margin:26px 0 12px}
.section-title:first-child{margin-top:0}
.card{background:var(--card);border:1px solid var(--line);border-radius:var(--radius);padding:22px}
.card + .card{margin-top:16px}
.card-head{display:flex;justify-content:space-between;align-items:center;margin-bottom:16px}
.card-eyebrow{font-size:.66rem;font-weight:800;letter-spacing:.12em;text-transform:uppercase;color:var(--ink-faint)}
.link-btn{background:none;border:none;color:var(--cyan);font-size:.78rem;font-weight:700;cursor:pointer;font-family:inherit}

/* ── Hero / tank visual ──────────────────────────────────── */
.hero{position:relative;overflow:hidden}
.hero::before{content:"";position:absolute;top:-40%;right:-25%;width:55%;height:75%;
  background:radial-gradient(circle,rgba(34,211,238,.12),transparent 70%);pointer-events:none}
.status-chip{display:flex;align-items:center;gap:7px;font-size:.72rem;font-weight:700;padding:5px 12px;border-radius:99px;
  background:rgba(52,211,153,.12);color:var(--on);border:1px solid rgba(52,211,153,.25)}
.status-chip .pulse{width:7px;height:7px;border-radius:50%;background:currentColor;box-shadow:0 0 8px currentColor;animation:pulse 1.6s infinite}
@keyframes pulse{0%,100%{opacity:1}50%{opacity:.35}}
.tank-row{display:flex;gap:24px;align-items:center}
.tank{width:66px;height:126px;border-radius:11px;border:2px solid var(--line);position:relative;overflow:hidden;background:#080a0f;flex-shrink:0}
.tank-fill{position:absolute;bottom:0;left:0;right:0;height:50%;border-radius:0 0 9px 9px;
  background:linear-gradient(180deg,var(--cyan),var(--cyan2));transition:height .8s ease,background .5s}
.tank-fill::before{content:"";position:absolute;top:-5px;left:0;right:0;height:10px;border-radius:50%/7px;
  background:radial-gradient(ellipse at 30% 50%,rgba(255,255,255,.5),transparent 60%),var(--cyan);opacity:.7}
.tank-glass{position:absolute;top:4px;left:4px;width:7px;bottom:4px;background:linear-gradient(180deg,rgba(255,255,255,.14),transparent);border-radius:4px}
.tank-pct{position:absolute;top:8px;left:0;right:0;text-align:center;font-size:.66rem;font-weight:800;color:var(--ink);
  text-shadow:0 1px 4px rgba(0,0,0,.6);font-variant-numeric:tabular-nums}
.tank.big{width:120px;height:230px}
.tank.big .tank-pct{font-size:1rem;top:16px}
.hero-meta{flex:1;min-width:0}
.hero-meta h2{font-size:1.35rem;margin-bottom:5px}
.hero-meta p{font-size:.83rem;color:var(--ink-soft)}
.stat-grid{display:grid;grid-template-columns:1fr 1fr;gap:10px;margin-top:14px}
.stat{background:rgba(255,255,255,.02);border:1px solid var(--line);border-radius:11px;padding:9px 11px}
.stat b{display:block;font-size:.92rem;font-weight:800;color:var(--cyan);font-variant-numeric:tabular-nums}
.stat span{font-size:.6rem;color:var(--ink-faint);font-weight:700;text-transform:uppercase;letter-spacing:.05em}
.timer-block{margin-top:20px;padding-top:18px;border-top:1px solid var(--line);display:none}
.timer-block.active{display:block}
.timer-head{display:flex;justify-content:space-between;font-size:.78rem;color:var(--ink-soft);margin-bottom:8px}
.timer-head b{color:var(--cyan);font-variant-numeric:tabular-nums;font-weight:700}
.timer-head b.inf{color:var(--violet)}
.track{height:6px;background:#080a0f;border-radius:99px;overflow:hidden;border:1px solid var(--line)}
.track-fill{height:100%;width:0%;border-radius:99px;transition:width .8s linear;
  background:linear-gradient(90deg,var(--cyan2),var(--cyan));box-shadow:0 0 10px rgba(34,211,238,.4)}
.track-fill.inf{width:100%!important;background:linear-gradient(90deg,#7c3aed,var(--violet))}

/* ── Quick stat tiles ────────────────────────────────────── */
.tile{background:var(--card);border:1px solid var(--line);border-radius:16px;padding:16px}
.tile-ico{width:34px;height:34px;border-radius:10px;display:flex;align-items:center;justify-content:center;margin-bottom:10px;
  background:rgba(34,211,238,.1)}
.tile-ico svg{width:17px;height:17px;stroke:var(--cyan)}
.tile b{display:block;font-size:.95rem;font-weight:800}
.tile span{font-size:.7rem;color:var(--ink-faint);font-weight:600}
.tile.warn .tile-ico{background:rgba(251,191,36,.12)}.tile.warn .tile-ico svg{stroke:var(--warn)}
.tile.bad .tile-ico{background:rgba(251,113,133,.12)}.tile.bad .tile-ico svg{stroke:var(--off)}

/* ── Buttons ─────────────────────────────────────────────── */
.btn-grid-3{display:grid;grid-template-columns:1fr 1fr 1fr;gap:12px}
.btn{display:flex;flex-direction:column;align-items:center;justify-content:center;gap:6px;padding:18px 8px;
  border-radius:15px;font-family:inherit;font-size:.83rem;font-weight:800;cursor:pointer;transition:transform .12s,opacity .15s}
.btn:active{transform:scale(.96);opacity:.85}
.btn .ico{width:20px;height:20px}
.btn-sub{font-size:.62rem;font-weight:600;opacity:.75}
.btn-start{background:linear-gradient(160deg,#0e2530,#0a1620);border:1px solid rgba(34,211,238,.35);color:var(--cyan)}
.btn-inf{background:linear-gradient(160deg,#241a38,#160f22);border:1px solid rgba(167,139,250,.4);color:var(--violet)}
.btn-off{background:linear-gradient(160deg,#2a1418,#180c0e);border:1px solid rgba(251,113,133,.35);color:var(--off)}
.maint-row{display:flex;gap:10px;flex-wrap:wrap}
.btn-maint{display:inline-flex;align-items:center;gap:7px;background:var(--card);border:1px solid var(--line);color:var(--ink-soft);
  border-radius:10px;padding:9px 14px;font-family:inherit;font-size:.78rem;font-weight:700;cursor:pointer;transition:border-color .15s,color .15s}
.btn-maint:hover{border-color:rgba(34,211,238,.4);color:var(--cyan)}
.btn-maint .ico{width:15px;height:15px;flex-shrink:0}
.btn-locked{opacity:.35;pointer-events:none;filter:grayscale(.6)}
.btn-primary{background:linear-gradient(135deg,#0891b2,#22d3ee);color:#04141a;border:none;border-radius:12px;
  padding:13px 20px;font-family:inherit;font-size:.85rem;font-weight:800;cursor:pointer;display:inline-flex;
  align-items:center;gap:8px;transition:opacity .15s,transform .1s}
.btn-primary:active{transform:scale(.97);opacity:.85}
.btn-ghost{background:none;border:1px solid var(--line);color:var(--ink-soft);border-radius:12px;padding:9px 14px;
  font-family:inherit;font-size:.78rem;font-weight:700;cursor:pointer}
.save-btn{width:100%;margin-top:18px;padding:15px;background:linear-gradient(135deg,#0891b2,#22d3ee);color:#04141a;
  border:none;border-radius:12px;font-family:inherit;font-size:.92rem;font-weight:800;cursor:pointer;
  display:flex;align-items:center;justify-content:center;gap:8px;transition:opacity .15s,transform .1s,background .3s}
.save-btn:active{transform:scale(.98);opacity:.88}
.save-btn.pending{background:linear-gradient(135deg,#92400e,#fbbf24)!important;color:#1c1206!important;animation:pulse-save 1.4s ease-in-out infinite}
@keyframes pulse-save{0%,100%{opacity:1}50%{opacity:.72}}

/* ── Rows / toggles / sliders ────────────────────────────── */
.row{display:flex;align-items:center;justify-content:space-between;padding:14px 0;border-top:1px solid var(--line);gap:12px}
.row:first-child{border-top:none}
.row-label{font-size:.85rem;font-weight:700}
.row-label small{display:block;font-size:.7rem;color:var(--ink-faint);font-weight:500;margin-top:1px}
.row-right{display:flex;align-items:center;gap:10px;flex-shrink:0}
.live-val{font-size:.74rem;font-weight:800;color:var(--cyan);background:rgba(34,211,238,.1);padding:3px 9px;
  border-radius:6px;font-variant-numeric:tabular-nums;border:1px solid rgba(34,211,238,.2)}
.badge{font-size:.7rem;font-weight:800;padding:3px 9px;border-radius:99px}
.badge.ok{background:rgba(52,211,153,.12);color:var(--on)}
.badge.err{background:rgba(251,113,133,.12);color:var(--off)}
.badge.muted{background:var(--card2);color:var(--ink-faint)}
.switch{position:relative;width:42px;height:24px;flex-shrink:0}
.switch input{opacity:0;position:absolute;inset:0}
.switch .strack{position:absolute;inset:0;background:#080a0f;border-radius:99px;border:1px solid var(--line);transition:.2s}
.switch .strack::after{content:"";position:absolute;width:16px;height:16px;left:3px;top:3px;background:var(--ink-faint);border-radius:50%;transition:.2s}
.switch input:checked + .strack{border-color:rgba(34,211,238,.5);background:rgba(34,211,238,.12)}
.switch input:checked + .strack::after{transform:translateX(18px);background:var(--cyan);box-shadow:0 0 8px rgba(34,211,238,.6)}
.slide-row{padding:15px 0;border-top:1px solid var(--line)}
.slide-row:first-child{border-top:none}
.slide-readout{display:flex;justify-content:space-between;align-items:center;gap:12px;margin-bottom:9px}
.slide-readout .ts-label{font-size:.85rem;font-weight:500}
.slide-readout .ts-label small{display:block;font-size:.7rem;color:var(--ink-faint);margin-top:1px}
.ts-val{font-size:.82rem;color:var(--cyan);font-weight:800;font-variant-numeric:tabular-nums;transition:color .2s;min-width:44px;text-align:center}
.ts-val.pending{color:var(--warn)}
input[type=range]{width:100%;accent-color:var(--cyan)}
.power-row{display:flex;align-items:center;justify-content:space-between;padding:15px 0 6px}
.power-adj{display:flex;align-items:center;gap:10px}
.ts-btn{width:32px;height:32px;border-radius:9px;border:1px solid var(--line);background:#080a0f;color:var(--ink);
  font-weight:800;cursor:pointer;font-size:1.1rem}
.power-bar{display:flex;gap:3px;margin:10px 0 6px}
.power-pip{height:6px;flex:1;border-radius:3px;background:#080a0f;border:1px solid var(--line)}
.power-pip.on{background:linear-gradient(90deg,var(--cyan2),var(--cyan));border-color:transparent}

/* ── Schedule ────────────────────────────────────────────── */
.sched-item{display:flex;align-items:center;gap:14px;padding:14px 0;border-top:1px solid var(--line)}
.sched-item:first-child{border-top:none}
.sched-time{font-size:1.05rem;font-weight:800;font-variant-numeric:tabular-nums;min-width:64px}
.sched-meta{flex:1;font-size:.75rem;color:var(--ink-faint);font-weight:600}
.sched-del{background:none;border:none;color:var(--ink-faint);cursor:pointer;width:30px;height:30px;border-radius:8px;
  display:flex;align-items:center;justify-content:center;flex-shrink:0}
.sched-del:hover{background:rgba(251,113,133,.1);color:var(--off)}
.sched-del svg{width:15px;height:15px}
.empty-note{font-size:.82rem;color:var(--ink-faint);text-align:center;padding:20px 0}
.add-form{display:grid;grid-template-columns:1fr 1fr;gap:12px;margin-top:4px}
.form-field label{display:block;font-size:.7rem;font-weight:700;color:var(--ink-faint);text-transform:uppercase;letter-spacing:.05em;margin-bottom:6px}
.form-field input[type=time],.form-field input[type=number]{width:100%;background:#080a0f;border:1px solid var(--line);
  border-radius:9px;padding:10px 11px;color:var(--ink);font-family:inherit;font-size:.85rem}

/* ── Logs ────────────────────────────────────────────────── */
.log-item{display:flex;justify-content:space-between;gap:14px;padding:12px 0;border-top:1px solid var(--line);font-size:.83rem}
.log-item:first-child{border-top:none}
.log-ago{color:var(--ink-faint);font-size:.72rem;flex-shrink:0;font-variant-numeric:tabular-nums}

/* ── Misc ────────────────────────────────────────────────── */
.toast{position:fixed;bottom:24px;left:50%;transform:translateX(-50%) translateY(80px);background:#161c28;color:var(--on);
  padding:10px 22px;border-radius:99px;font-size:.85rem;font-weight:600;border:1px solid rgba(52,211,153,.3);
  transition:transform .35s cubic-bezier(.34,1.56,.64,1),opacity .35s;opacity:0;white-space:nowrap;z-index:999}
.toast.show{transform:translateX(-50%) translateY(0);opacity:1}
.toast.err{color:var(--off);border-color:rgba(251,113,133,.4)}
.note{font-size:.72rem;color:var(--ink-faint);margin-top:26px;text-align:center;line-height:1.7}
.test-badge{display:none;font-size:.6rem;font-weight:700;padding:2px 8px;border-radius:99px;background:rgba(251,191,36,.15);
  color:var(--warn);border:1px solid rgba(251,191,36,.4);margin-left:6px;vertical-align:middle}
.test-badge.show{display:inline-block}

@media (max-width:900px){
  .sidebar{width:min(84vw,320px);transform:translateX(-100%);box-shadow:0 0 40px rgba(0,0,0,.5)}
  .sidebar.open{transform:translateX(0)}
  .main{margin-left:0;padding:0 16px 60px}
  .hamburger{display:flex}
  .side-brand{padding:26px 20px 22px}
  .brand-mark{width:48px;height:48px}
  .brand-line1{font-size:1.15rem}
  .nav-item{padding:14px 14px;font-size:.92rem}
  .nav-item svg{width:20px;height:20px}
  .grid-4{grid-template-columns:1fr 1fr}
  .grid-3{grid-template-columns:1fr 1fr}
  .grid-2{grid-template-columns:1fr}
  .add-form{grid-template-columns:1fr}
  .tank-row{flex-wrap:wrap}
}

@media (max-width:480px){
  .main{padding:0 12px 60px}
  .topbar{gap:8px;padding:16px 0 14px}
  .topbar-title{font-size:1rem}
  .tb-chip{font-size:.66rem;padding:5px 9px}
  #tbClock{display:none}
  .stat-grid{grid-template-columns:1fr}
  .grid-4{grid-template-columns:1fr}
  .grid-3{grid-template-columns:1fr}
  .card{padding:18px}
  .hero-meta h2{font-size:1.1rem}
}
</style>
</head>
<body>
<div class="app">

<aside class="sidebar" id="sidebar">
  <div class="side-brand">
    <div class="brand-mark"><img class="side-logo" src="/logo.jpg" alt="PooKooli"></div>
    <div class="brand-word">
      <div class="brand-line1">Poo<span class="accent">Kooli</span></div>
      <div class="brand-line2">FOUNTAIN <span class="accent">X</span></div>
    </div>
  </div>
  <nav class="side-nav">
    <button class="nav-item active" data-page="dashboard" onclick="showPage('dashboard')">
      <svg viewBox="0 0 24 24" fill="none" stroke-width="2" stroke-linecap="round" stroke-linejoin="round"><rect x="3" y="3" width="7" height="9" rx="1.5"/><rect x="14" y="3" width="7" height="5" rx="1.5"/><rect x="14" y="12" width="7" height="9" rx="1.5"/><rect x="3" y="16" width="7" height="5" rx="1.5"/></svg>
      Dashboard
    </button>
    <button class="nav-item" data-page="tank" onclick="showPage('tank')">
      <svg viewBox="0 0 24 24" fill="none" stroke-width="2" stroke-linecap="round" stroke-linejoin="round"><path d="M12 2c3 4 6 7 6 11a6 6 0 1 1-12 0c0-4 3-7 6-11z"/></svg>
      Water Tank
    </button>
    <button class="nav-item" data-page="sensors" onclick="showPage('sensors')">
      <svg viewBox="0 0 24 24" fill="none" stroke-width="2" stroke-linecap="round" stroke-linejoin="round"><circle cx="12" cy="12" r="2"/><circle cx="12" cy="12" r="6"/><circle cx="12" cy="12" r="10"/></svg>
      Sensors
    </button>
    <button class="nav-item" data-page="pump" onclick="showPage('pump')">
      <svg viewBox="0 0 24 24" fill="none" stroke-width="2" stroke-linecap="round" stroke-linejoin="round"><circle cx="12" cy="12" r="8"/><path d="M12 8v4l3 2"/></svg>
      Pump Control
    </button>
    <button class="nav-item" data-page="schedule" onclick="showPage('schedule')">
      <svg viewBox="0 0 24 24" fill="none" stroke-width="2" stroke-linecap="round" stroke-linejoin="round"><rect x="3" y="4" width="18" height="17" rx="2"/><path d="M3 9h18M8 2v4M16 2v4"/></svg>
      Schedule
    </button>
    <button class="nav-item" data-page="settings" onclick="showPage('settings')">
      <svg viewBox="0 0 24 24" fill="none" stroke-width="2" stroke-linecap="round" stroke-linejoin="round"><circle cx="12" cy="12" r="3"/><path d="M19.4 15a1.7 1.7 0 0 0 .34 1.87l.06.06a2 2 0 1 1-2.83 2.83l-.06-.06a1.7 1.7 0 0 0-1.87-.34 1.7 1.7 0 0 0-1.04 1.56V21a2 2 0 1 1-4 0v-.09A1.7 1.7 0 0 0 8.96 19a1.7 1.7 0 0 0-1.87.34l-.06.06a2 2 0 1 1-2.83-2.83l.06-.06A1.7 1.7 0 0 0 4.6 15a1.7 1.7 0 0 0-1.56-1.04H3a2 2 0 1 1 0-4h.09A1.7 1.7 0 0 0 4.6 8.96a1.7 1.7 0 0 0-.34-1.87l-.06-.06a2 2 0 1 1 2.83-2.83l.06.06A1.7 1.7 0 0 0 9 4.6a1.7 1.7 0 0 0 1.04-1.56V3a2 2 0 1 1 4 0v.09A1.7 1.7 0 0 0 15 4.6a1.7 1.7 0 0 0 1.87-.34l.06-.06a2 2 0 1 1 2.83 2.83l-.06.06A1.7 1.7 0 0 0 19.4 9a1.7 1.7 0 0 0 1.56 1.04H21a2 2 0 1 1 0 4h-.09A1.7 1.7 0 0 0 19.4 15z"/></svg>
      Settings
    </button>
    <button class="nav-item" data-page="device" onclick="showPage('device')">
      <svg viewBox="0 0 24 24" fill="none" stroke-width="2" stroke-linecap="round" stroke-linejoin="round"><rect x="4" y="2" width="16" height="20" rx="2"/><path d="M9 22v-4h6v4M8 6h.01M12 6h.01"/></svg>
      Device Info
    </button>
    <button class="nav-item" data-page="debug" onclick="showPage('debug')">
      <svg viewBox="0 0 24 24" fill="none" stroke-width="2" stroke-linecap="round" stroke-linejoin="round"><path d="M14.7 6.3a1 1 0 0 0 0 1.4l1.6 1.6a1 1 0 0 0 1.4 0l3.77-3.77a6 6 0 0 1-7.94 7.94l-6.91 6.91a2.12 2.12 0 0 1-3-3l6.91-6.91a6 6 0 0 1 7.94-7.94z"/></svg>
      Debug
    </button>
    <button class="nav-item" data-page="logs" onclick="showPage('logs')">
      <svg viewBox="0 0 24 24" fill="none" stroke-width="2" stroke-linecap="round" stroke-linejoin="round"><path d="M4 19V5a2 2 0 0 1 2-2h8l6 6v10a2 2 0 0 1-2 2H6a2 2 0 0 1-2-2z"/><path d="M14 3v6h6M8 13h8M8 17h5"/></svg>
      Logs
    </button>
  </nav>
  <div class="side-foot">
    <div class="side-status"><span class="dot-sm" id="sideHealthDot"></span><span id="sideHealthText">System Healthy</span></div>
    <div class="side-fw">Firmware <span id="sideFwVer">--</span></div>
  </div>
</aside>
<div class="scrim" id="scrim" onclick="closeSidebar()"></div>

<div class="main">
  <header class="topbar">
    <button class="hamburger" onclick="openSidebar()">
      <svg viewBox="0 0 24 24" fill="none" stroke="currentColor" stroke-width="2.2" stroke-linecap="round"><path d="M3 6h18M3 12h18M3 18h18"/></svg>
    </button>
    <div class="topbar-title" id="pageTitle">Dashboard</div>
    <div class="topbar-right">
      <span class="tb-chip" id="tbWifi">WiFi --</span>
      <span class="tb-chip" id="tbClock">--:--:--</span>
      <button class="icon-btn" id="btnSystemIcon" onclick="toggleSystemIcon()" title="System On/Off">
        <svg viewBox="0 0 24 24" fill="none" stroke="currentColor" stroke-width="2.4" stroke-linecap="round"><path d="M12 2v8"/><path d="M18.4 6.6a9 9 0 1 1-12.8 0"/></svg>
      </button>
      <button class="icon-btn" id="btnRestartIcon" onclick="restartBoard()" title="Restart Board">
        <svg viewBox="0 0 24 24" fill="none" stroke="currentColor" stroke-width="2.4" stroke-linecap="round" stroke-linejoin="round"><path d="M3 12a9 9 0 1 1 3 6.7"/><path d="M3 17v-5h5"/></svg>
      </button>
    </div>
  </header>

  <div class="master-off-banner" id="masterOffBanner">
    <span style="font-size:1.3rem">🔌</span><span>System is OFF — pump will not start until you turn it back on.</span>
  </div>

  <!-- ══ Dashboard ══ -->
  <section class="page active" id="page-dashboard">
    <div class="card hero">
      <div class="card-head">
        <span class="card-eyebrow">Live Status</span>
        <span class="status-chip" id="statusChip"><span class="pulse"></span><span id="statusChipText">Loading…</span></span>
      </div>
      <div class="error-banner" id="errorBanner">
        <div class="error-ico">🪣</div>
        <div><div class="error-title">Water level is low!</div><div class="error-msg">Refill the reservoir before using the pump.</div></div>
      </div>
      <div class="tank-row">
        <div class="tank"><div class="tank-fill" id="tankFillD" style="height:0%"></div><div class="tank-glass"></div><div class="tank-pct" id="tankPctD">--%</div></div>
        <div class="hero-meta">
          <h2 id="pumpLabel">Loading…</h2>
          <p id="pumpSub"></p>
          <div class="stat-grid">
            <div class="stat"><b id="statPower">--</b><span>Power</span></div>
            <div class="stat"><b id="statUptime">--</b><span>Uptime</span></div>
            <div class="stat"><b id="dashS1Dist">--</b><span>Sensor 1 · Right</span></div>
            <div class="stat"><b id="dashS2Dist">--</b><span>Sensor 2 · Left</span></div>
          </div>
        </div>
      </div>
      <div class="timer-block" id="timerWrap">
        <div class="timer-head"><span id="timerLabel">Pump running</span><b class="t-time" id="timerText">--:--</b></div>
        <div class="track"><div class="track-fill" id="barFill"></div></div>
      </div>
    </div>

    <div class="section-title">Control</div>
    <div class="btn-grid-3">
      <button class="btn btn-start" id="btnOn" onclick="sendCmd('on')"><svg class="ico" viewBox="0 0 24 24" fill="none" stroke="currentColor" stroke-width="2.4" stroke-linecap="round" stroke-linejoin="round"><polygon points="6 3 20 12 6 21 6 3"/></svg>Start<span class="btn-sub" id="wifiDurLabel">2m</span></button>
      <button class="btn btn-inf" id="btnInf" onclick="sendCmd('continuous')"><svg class="ico" viewBox="0 0 24 24" fill="none" stroke="currentColor" stroke-width="2.4" stroke-linecap="round"><path d="M18.178 8c5.096 0 5.096 8 0 8-5.095 0-7.133-8-12.739-8-4.585 0-4.585 8 0 8 5.606 0 7.644-8 12.74-8z"/></svg>Infinite<span class="btn-sub">continuous</span></button>
      <button class="btn btn-off" onclick="sendCmd('off')"><svg class="ico" viewBox="0 0 24 24" fill="none" stroke="currentColor" stroke-width="2.4" stroke-linecap="round" stroke-linejoin="round"><rect x="5" y="5" width="14" height="14" rx="2"/></svg>Stop<span class="btn-sub">immediately</span></button>
    </div>

    <div class="section-title">Quick Status</div>
    <div class="grid-3">
      <div class="tile" id="tileWater"><div class="tile-ico"><svg viewBox="0 0 24 24" fill="none" stroke-width="2" stroke-linecap="round" stroke-linejoin="round"><path d="M12 2c3 4 6 7 6 11a6 6 0 1 1-12 0c0-4 3-7 6-11z"/></svg></div><b id="tileWaterVal">--%</b><span>Water level</span></div>
      <div class="tile" id="tilePump"><div class="tile-ico"><svg viewBox="0 0 24 24" fill="none" stroke-width="2" stroke-linecap="round" stroke-linejoin="round"><circle cx="12" cy="12" r="8"/><path d="M12 8v4l3 2"/></svg></div><b id="tilePumpVal">--</b><span>Pump</span></div>
      <div class="tile" id="tileWifi"><div class="tile-ico"><svg viewBox="0 0 24 24" fill="none" stroke-width="2" stroke-linecap="round" stroke-linejoin="round"><path d="M5 12.5a11 11 0 0 1 14 0M8.5 16a6 6 0 0 1 7 0M12 19.5h.01"/></svg></div><b id="tileWifiVal">--</b><span>WiFi signal</span></div>
    </div>

    <div class="section-title">Recent Activity</div>
    <div class="card" id="dashLogList"><div class="empty-note">No activity yet</div></div>
    <button class="link-btn" id="dashViewAllBtn" onclick="showPage('logs')" style="display:none;margin-top:10px">View all →</button>
  </section>

  <!-- ══ Water Tank ══ -->
  <section class="page" id="page-tank">
    <div class="card hero">
      <div class="tank-row" style="justify-content:center;gap:32px">
        <div class="tank big"><div class="tank-fill" id="tankFillT" style="height:0%"></div><div class="tank-glass"></div><div class="tank-pct" id="tankPctT">--%</div></div>
        <div class="hero-meta">
          <span class="badge" id="tankBadge">--</span>
          <h2 style="margin-top:10px" id="tankHeadline">Reading tank…</h2>
          <p id="tankSub">Water level sensor, ADC channel.</p>
        </div>
      </div>
    </div>
    <div class="section-title">About this reading</div>
    <div class="card">
      <p style="font-size:.85rem;color:var(--ink-soft);line-height:1.6">
        The fountain refuses to start the pump once the level drops below the low-water threshold, to protect the pump from running dry.
        A “Low” or “Critical” badge above means it's time to refill the reservoir.
      </p>
    </div>
  </section>

  <!-- ══ Sensors ══ -->
  <section class="page" id="page-sensors">
    <div class="section-title">Laser Sensors</div>
    <div class="grid-2">
      <div class="card">
        <div class="card-head"><span class="card-eyebrow">Sensor 1 · Right</span><span class="badge" id="dbgS1Status">checking…</span></div>
        <div class="row"><div class="row-label">I2C address</div><div class="row-right"><span class="live-val">0x30</span></div></div>
        <div class="row"><div class="row-label">XSHUT pin</div><div class="row-right"><span class="live-val">GPIO32</span></div></div>
        <div class="row"><div class="row-label">Live distance</div><div class="row-right"><span class="live-val" id="hwS1Dist">--</span></div></div>
        <div class="row"><div class="row-label">Trigger distance<small>Change in Settings</small></div><div class="row-right"><span class="live-val" id="senTrig1">--</span></div></div>
        <div class="row"><div class="row-label">Trigger run time<small>Change in Settings</small></div><div class="row-right"><span class="live-val" id="senDur1">--</span></div></div>
      </div>
      <div class="card">
        <div class="card-head"><span class="card-eyebrow">Sensor 2 · Left</span><span class="badge" id="dbgS2Status">checking…</span></div>
        <div class="row"><div class="row-label">I2C address</div><div class="row-right"><span class="live-val">0x31</span></div></div>
        <div class="row"><div class="row-label">XSHUT pin<small id="lblLaser2"></small></div><div class="row-right"><span class="live-val">GPIO33</span></div></div>
        <div class="row"><div class="row-label">Live distance</div><div class="row-right"><span class="live-val" id="hwS2Dist">--</span></div></div>
        <div class="row"><div class="row-label">Trigger distance<small>Change in Settings</small></div><div class="row-right"><span class="live-val" id="senTrig2">--</span></div></div>
        <div class="row"><div class="row-label">Trigger run time<small>Change in Settings</small></div><div class="row-right"><span class="live-val" id="senDur2">--</span></div></div>
      </div>
    </div>
  </section>

  <!-- ══ Pump Control ══ -->
  <section class="page" id="page-pump">
    <div class="card hero">
      <div class="card-head">
        <span class="card-eyebrow">Pump</span>
        <span class="status-chip" id="statusChip2"><span class="pulse"></span><span id="statusChipText2">Loading…</span></span>
      </div>
      <h2 id="pumpLabel2" style="margin-bottom:4px">Loading…</h2>
      <p id="pumpSub2" style="font-size:.83rem;color:var(--ink-soft)"></p>
      <div class="timer-block" id="timerWrap2">
        <div class="timer-head"><span id="timerLabel2">Pump running</span><b class="t-time" id="timerText2">--:--</b></div>
        <div class="track"><div class="track-fill" id="barFill2"></div></div>
      </div>
    </div>
    <div class="section-title">Control</div>
    <div class="btn-grid-3">
      <button class="btn btn-start" id="btnOnP" onclick="sendCmd('on')"><svg class="ico" viewBox="0 0 24 24" fill="none" stroke="currentColor" stroke-width="2.4" stroke-linecap="round" stroke-linejoin="round"><polygon points="6 3 20 12 6 21 6 3"/></svg>Start<span class="btn-sub" id="wifiDurLabel2">2m</span></button>
      <button class="btn btn-inf" id="btnInfP" onclick="sendCmd('continuous')"><svg class="ico" viewBox="0 0 24 24" fill="none" stroke="currentColor" stroke-width="2.4" stroke-linecap="round"><path d="M18.178 8c5.096 0 5.096 8 0 8-5.095 0-7.133-8-12.739-8-4.585 0-4.585 8 0 8 5.606 0 7.644-8 12.74-8z"/></svg>Infinite<span class="btn-sub">continuous</span></button>
      <button class="btn btn-off" onclick="sendCmd('off')"><svg class="ico" viewBox="0 0 24 24" fill="none" stroke="currentColor" stroke-width="2.4" stroke-linecap="round" stroke-linejoin="round"><rect x="5" y="5" width="14" height="14" rx="2"/></svg>Stop<span class="btn-sub">immediately</span></button>
    </div>
    <div class="section-title">Run Settings</div>
    <div class="card">
      <div class="row"><div class="row-label">Pump power<small>Motor speed while running</small></div><div class="row-right"><span class="live-val" id="pumpPowerRO">--/10</span></div></div>
      <div class="row"><div class="row-label">App start duration<small>Time run when Start is pressed from this page</small></div><div class="row-right"><span class="live-val" id="pumpWifiRO">--</span></div></div>
      <p style="font-size:.76rem;color:var(--ink-faint);margin-top:14px;line-height:1.6">To change power or run duration, go to <button class="link-btn" onclick="showPage('settings')" style="padding:0">Settings →</button><br>Safety: laser-triggered runs auto-stop after 5 minutes regardless of sensor state, and Touch always stops any running source instantly.</p>
    </div>
  </section>

  <!-- ══ Schedule ══ -->
  <section class="page" id="page-schedule">
    <div class="sync-banner" id="syncBanner"><span style="font-size:1.2rem">⏳</span><span>Waiting for the device to sync time over the internet — schedules will start working once that completes (usually within a few seconds of boot).</span></div>
    <div class="card">
      <div class="card-head"><span class="card-eyebrow">Daily Triggers</span><span class="badge muted" id="schedClock">--:--:--</span></div>
      <div id="schedList"><div class="empty-note">No scheduled times yet — add one below</div></div>
    </div>
    <div class="section-title">Add a Schedule</div>
    <div class="card">
      <div class="add-form">
        <div class="form-field"><label>Time</label><input type="time" id="schedTime" value="08:00"></div>
        <div class="form-field"><label>Run duration (sec)</label><input type="number" id="schedDur" min="5" max="3600" value="30"></div>
      </div>
      <button class="btn-primary" style="margin-top:16px;width:100%;justify-content:center" onclick="addSchedule()">+ Add Schedule</button>
    </div>
  </section>

  <!-- ══ Settings ══ -->
  <section class="page" id="page-settings">
    <div class="section-title">Hardware Control</div>
    <div class="card">
      <div class="row">
        <div class="row-label">Right — Laser Sensor 1<small>Enable or disable — see live readings on the Sensors tab</small></div>
        <div class="row-right"><label class="switch"><input type="checkbox" id="swLaser1" onchange="toggleSwitch('laser1',this.checked)"><span class="strack"></span></label></div>
      </div>
      <div class="row">
        <div class="row-label">Left — Laser Sensor 2<small>Enable or disable — see live readings on the Sensors tab</small></div>
        <div class="row-right"><label class="switch"><input type="checkbox" id="swLaser2" onchange="toggleSwitch('laser2',this.checked)"><span class="strack"></span></label></div>
      </div>
      <div class="row">
        <div class="row-label">Touch Sensor<small>Capacitive module — manual start / stop override</small></div>
        <div class="row-right"><label class="switch"><input type="checkbox" id="swTouch" onchange="toggleSwitch('touch',this.checked)"><span class="strack"></span></label></div>
      </div>
      <div class="row">
        <div class="row-label">System<small>Master on/off — same as the header toggle</small></div>
        <div class="row-right"><label class="switch"><input type="checkbox" id="swSystem" onchange="toggleSwitch('system',this.checked)"><span class="strack"></span></label></div>
      </div>
    </div>

    <div class="section-title">Timer &amp; Distance <span class="test-badge show" style="margin-left:8px;background:none;border:none;color:var(--ink-faint);font-weight:600" id="pendingHint"></span></div>
    <div class="card">
      <div class="slide-row">
        <div class="slide-readout"><div class="ts-label">Touch button run time<small>Run time when the touch sensor triggers</small></div>
          <div class="power-adj"><button class="ts-btn" onclick="adjStep('touch',-5)">−</button><div class="ts-val" id="val-touch">1m</div><button class="ts-btn" onclick="adjStep('touch',5)">+</button></div>
        </div>
        <input type="range" id="range-touch" min="5" max="3600" step="5" value="60" oninput="adjRange('touch',this.value)">
      </div>
      <div class="slide-row">
        <div class="slide-readout"><div class="ts-label">App start run time<small>Time run when Start is pressed in the app</small></div>
          <div class="power-adj"><button class="ts-btn" onclick="adjStep('wifi',-5)">−</button><div class="ts-val" id="val-wifi">2m</div><button class="ts-btn" onclick="adjStep('wifi',5)">+</button></div>
        </div>
        <input type="range" id="range-wifi" min="5" max="3600" step="5" value="120" oninput="adjRange('wifi',this.value)">
      </div>
      <div class="slide-row">
        <div class="slide-readout"><div class="ts-label">Laser trigger run time<small>Run time once a laser sensor triggers</small></div>
          <div class="power-adj"><button class="ts-btn" onclick="adjStep('pir',-5)">−</button><div class="ts-val" id="val-pir">1m</div><button class="ts-btn" onclick="adjStep('pir',5)">+</button></div>
        </div>
        <input type="range" id="range-pir" min="5" max="3600" step="5" value="60" oninput="adjRange('pir',this.value)">
      </div>
      <div class="slide-row">
        <div class="slide-readout"><div class="ts-label">Right — Sensor 1 trigger distance<small>Trigger when an object is closer than this</small></div>
          <div class="power-adj"><button class="ts-btn" onclick="adjStep('distance1',-1)">−</button><div class="ts-val" id="val-distance1">15 cm</div><button class="ts-btn" onclick="adjStep('distance1',1)">+</button></div>
        </div>
        <input type="range" id="rangeDistance1" min="5" max="70" step="1" value="15" oninput="adjRange('distance1',this.value)">
      </div>
      <div class="slide-row">
        <div class="slide-readout"><div class="ts-label">Left — Sensor 2 trigger distance<small>Trigger when an object is closer than this</small></div>
          <div class="power-adj"><button class="ts-btn" onclick="adjStep('distance2',-1)">−</button><div class="ts-val" id="val-distance2">15 cm</div><button class="ts-btn" onclick="adjStep('distance2',1)">+</button></div>
        </div>
        <input type="range" id="rangeDistance2" min="5" max="70" step="1" value="15" oninput="adjRange('distance2',this.value)">
      </div>
      <div class="power-row">
        <div class="row-label">Pump power<small>Motor speed while running</small></div>
        <div class="power-adj"><button class="ts-btn" onclick="adj('power',-1)">−</button><div class="ts-val" id="val-power">8/10</div><button class="ts-btn" onclick="adj('power',+1)">+</button></div>
      </div>
      <div class="power-bar" id="powerBar">
        <div class="power-pip" id="pip1"></div><div class="power-pip" id="pip2"></div><div class="power-pip" id="pip3"></div><div class="power-pip" id="pip4"></div><div class="power-pip" id="pip5"></div>
        <div class="power-pip" id="pip6"></div><div class="power-pip" id="pip7"></div><div class="power-pip" id="pip8"></div><div class="power-pip" id="pip9"></div><div class="power-pip" id="pip10"></div>
      </div>
      <button class="save-btn" id="saveBtn" onclick="saveSettings()">💾 Save Settings to Device</button>
    </div>
    <p class="note">Timers: 5 sec – 1 hour · Power: 1–10 · Distance: 5–70cm · Yellow = unsaved, tap Save to write to flash</p>
  </section>

  <!-- ══ Device Info ══ -->
  <section class="page" id="page-device">
    <div class="section-title">Network</div>
    <div class="card">
      <div class="row"><div class="row-label">WiFi network</div><div class="row-right"><span id="diSsid">--</span></div></div>
      <div class="row"><div class="row-label">IP address</div><div class="row-right"><span id="diIp">--</span></div></div>
      <div class="row"><div class="row-label">Signal strength</div><div class="row-right"><span id="diRssi">--</span></div></div>
      <div class="row"><div class="row-label">MAC address</div><div class="row-right"><span id="diMac">--</span></div></div>
    </div>
    <div class="section-title">Device</div>
    <div class="card">
      <div class="row"><div class="row-label">Uptime</div><div class="row-right"><span id="diUptime">--</span></div></div>
      <div class="row"><div class="row-label">Free memory</div><div class="row-right"><span id="diHeap">--</span></div></div>
      <div class="row"><div class="row-label">Lowest free memory this session</div><div class="row-right"><span id="diMinHeap">--</span></div></div>
      <div class="row"><div class="row-label">Chip</div><div class="row-right"><span id="diChip">--</span></div></div>
      <div class="row"><div class="row-label">Firmware version</div><div class="row-right"><span id="diFw">--</span></div></div>
      <div class="row"><div class="row-label">Time sync</div><div class="row-right"><span id="diTime">--</span></div></div>
    </div>
    <div class="section-title">Boot History <small style="font-weight:400;opacity:.6">(most recent first — survives crashes/resets)</small></div>
    <div class="card">
      <div id="diBootHistory" style="font-size:.85rem;color:var(--text-dim,#888)">Loading…</div>
    </div>
  </section>

  <!-- ══ Debug ══ -->
  <section class="page" id="page-debug">
    <div class="section-title">Water Test Mode</div>
    <div class="card">
      <div class="row">
        <div class="row-label">Water test mode<small id="lblTestMode">Forces level to 50% so the pump runs with an empty tank. Never saved — always off after a restart.</small></div>
        <div class="row-right"><label class="switch"><input type="checkbox" id="swTestMode" onchange="toggleSwitch('testmode',this.checked)"><span class="strack"></span></label></div>
      </div>
    </div>
    <div class="section-title">Maintenance</div>
    <div class="maint-row">
      <button class="btn-maint" id="btnI2cRecover" onclick="recoverI2C()"><svg class="ico" viewBox="0 0 24 24" fill="none" stroke="currentColor" stroke-width="2.2" stroke-linecap="round" stroke-linejoin="round"><path d="M3 12a9 9 0 1 1 3 6.7"/><path d="M3 17v-5h5"/></svg>Recover I2C Bus</button>
      <button class="btn-maint" onclick="restartBoard()"><svg class="ico" viewBox="0 0 24 24" fill="none" stroke="currentColor" stroke-width="2.2" stroke-linecap="round" stroke-linejoin="round"><path d="M3 12a9 9 0 1 1 3 6.7"/><path d="M3 17v-5h5"/></svg>Restart Board</button>
    </div>
  </section>

  <!-- ══ Logs ══ -->
  <section class="page" id="page-logs">
    <div class="section-title">Recent Activity</div>
    <div class="card" id="logList"><div class="empty-note">No activity yet</div></div>
  </section>

</div>
</div>
<div class="toast" id="toast"></div>

<script>
var settings = { pir:60, wifi:120, touch:60, power:8, distance1:15, distance2:15 };
var localOverride = new Set();
var MIN_SEC=5, MAX_SEC=3600, MIN_DIST=5, MAX_DIST=70;
var pumpEndTime=0, timerTick=null, lastDurationMs=0;
var elapsedTick=null, elapsedStart=0;
var currentPage='dashboard';
var logsTimer=null;

// ── Navigation ──────────────────────────────────────────────
var PAGE_TITLES = {dashboard:'Dashboard',tank:'Water Tank',sensors:'Sensors',pump:'Pump Control',schedule:'Schedule',settings:'Settings',device:'Device Info',debug:'Debug',logs:'Logs'};
var showPage = function(name) {
  currentPage = name;
  document.querySelectorAll('.page').forEach(function(p){ p.classList.toggle('active', p.id==='page-'+name); });
  document.querySelectorAll('.nav-item').forEach(function(b){ b.classList.toggle('active', b.dataset.page===name); });
  document.getElementById('pageTitle').textContent = PAGE_TITLES[name] || name;
  closeSidebar();
  if (logsTimer) { clearInterval(logsTimer); logsTimer=null; }
  if (name==='logs')     { fetchLogs(); logsTimer=setInterval(fetchLogs, 3000); }
  if (name==='schedule') { fetchSchedule(); fetchDeviceInfo(); }
  if (name==='device')   { fetchDeviceInfo(); }
};
var openSidebar  = function(){ document.getElementById('sidebar').classList.add('open'); document.getElementById('scrim').classList.add('show'); };
var closeSidebar = function(){ document.getElementById('sidebar').classList.remove('open'); document.getElementById('scrim').classList.remove('show'); };

var fmtDur = function(v) {
  if (v>=3600) { var h=Math.floor(v/3600), m=Math.floor((v%3600)/60); return h+'h'+(m?' '+m+'m':''); }
  if (v>=60)   { var m=Math.floor(v/60), s=v%60; return m+'m'+(s?' '+s+'s':''); }
  return v+'s';
};

var adj = function(key, delta) {
  localOverride.add(key);
  settings.power = Math.min(10, Math.max(1, settings.power+delta));
  render(key); updateSaveBtn();
};
var adjRange = function(key, val) {
  localOverride.add(key);
  var isDist = (key==='distance1'||key==='distance2');
  var lo = isDist?MIN_DIST:MIN_SEC, hi = isDist?MAX_DIST:MAX_SEC;
  settings[key] = Math.min(hi, Math.max(lo, parseInt(val,10)));
  render(key); updateSaveBtn();
};
var adjStep = function(key, delta) {
  localOverride.add(key);
  var isDist = (key==='distance1'||key==='distance2');
  var lo = isDist?MIN_DIST:MIN_SEC, hi = isDist?MAX_DIST:MAX_SEC;
  settings[key] = Math.min(hi, Math.max(lo, settings[key]+delta));
  render(key); updateSaveBtn();
};
var render = function(key) {
  var el = document.getElementById('val-'+key); if (!el) return;
  el.classList.toggle('pending', localOverride.has(key));
  if (key==='power') { el.textContent=settings.power+'/10'; renderPowerBar(); }
  else if (key==='distance1' || key==='distance2') {
    el.textContent=settings[key]+' cm';
    var sliderId=key==='distance1'?'rangeDistance1':'rangeDistance2';
    var s=document.getElementById(sliderId);
    if (s && document.activeElement!==s) s.value=settings[key];
    var senEl=document.getElementById(key==='distance1'?'senTrig1':'senTrig2');
    if (senEl) senEl.textContent=settings[key]+' cm';
  } else {
    var str=fmtDur(settings[key]);
    el.textContent=str;
    var s=document.getElementById('range-'+key);
    if (s && document.activeElement!==s) s.value=settings[key];
    if (key==='wifi') setAll(['wifiDurLabel','wifiDurLabel2'], function(el){ el.textContent=str; });
    if (key==='pir') setAll(['senDur1','senDur2'], function(el){ el.textContent=str; });
  }
};
var renderPowerBar = function() {
  var p=settings.power, pending=localOverride.has('power');
  for (var i=1;i<=10;i++) {
    var pip=document.getElementById('pip'+i); if (!pip) continue;
    pip.style.background = i<=p ? (pending?'#fbbf24':(i<=3?'#fb7185':i<=6?'#fbbf24':'#34d399')) : '#080a0f';
  }
};
var updateSaveBtn = function() {
  var btn=document.getElementById('saveBtn');
  if (localOverride.size>0) { btn.classList.add('pending'); btn.textContent='💾 Save ('+localOverride.size+' unsaved change'+(localOverride.size>1?'s':'')+')'; }
  else { btn.classList.remove('pending'); btn.textContent='💾 Save Settings to Device'; }
  var hint=document.getElementById('pendingHint');
  if (hint) hint.textContent = localOverride.size>0 ? '● unsaved' : '';
};
var saveSettings = async function() {
  var url='/settings?pir='+settings.pir+'&touch='+settings.touch+'&wifi='+settings.wifi+'&power='+settings.power+'&distance1='+settings.distance1+'&distance2='+settings.distance2;
  try {
    var j=await (await fetch(url)).json();
    if (j.ok) { localOverride.clear(); ['pir','wifi','touch','power','distance1','distance2'].forEach(render); updateSaveBtn(); showToast('✓ Saved!'); }
    else showToast('⚠ Save failed',true);
  } catch(e) { showToast('⚠ No connection',true); }
};
var sendCmd = async function(cmd) {
  if (cmd!=='off' && (window._pumpLocked || window._systemOff)) return;
  try { applyStatus(await (await fetch('/pump?cmd='+cmd)).json()); } catch(e) {}
};
var restartBoard = async function() {
  if (!confirm('Restart the board?\nFountain offline ~5 seconds.')) return;
  var btn=document.getElementById('btnRestartIcon');
  btn.disabled=true; btn.classList.add('spinning');
  try { await fetch('/restart'); } catch(e) {}
  var waited=0, poll=setInterval(async function() {
    waited++;
    try { var r=await fetch('/status'); if(r.ok){ clearInterval(poll); btn.disabled=false; btn.classList.remove('spinning'); showToast('✓ Back online'); applyStatus(await r.json()); } } catch(e) {}
    if (waited>30){ clearInterval(poll); btn.disabled=false; btn.classList.remove('spinning'); showToast('⚠ Not responding',true); }
  },1000);
};
var recoverI2C = async function() {
  var btn=document.getElementById('btnI2cRecover');
  btn.disabled=true; btn.innerHTML='⏳ Recovering…';
  try {
    var r = await fetch('/i2crecover');
    if (r.ok) { applyStatus(await r.json()); showToast('✓ Bus recovery done — check Sensors tab'); }
    else showToast('⚠ Recovery request failed', true);
  } catch(e) { showToast('⚠ No connection', true); }
  btn.disabled=false; btn.innerHTML='<svg class="ico" viewBox="0 0 24 24" fill="none" stroke="currentColor" stroke-width="2.2" stroke-linecap="round" stroke-linejoin="round"><path d="M3 12a9 9 0 1 1 3 6.7"/><path d="M3 17v-5h5"/></svg>Recover I2C Bus';
};
var toggleSystemIcon = function() {
  var icon=document.getElementById('btnSystemIcon');
  var next = !(icon.classList.contains('state-on'));
  toggleSwitch('system', next);
};
var toggleSwitch = async function(which, checked) {
  try { applyStatus(await (await fetch('/toggle?which='+which+'&state='+(checked?'1':'0'))).json()); showToast(checked?'✓ On':'✓ Off'); }
  catch(e) {
    showToast('⚠ No connection',true);
    var m={laser1:'swLaser1',laser2:'swLaser2',touch:'swTouch',testmode:'swTestMode',system:'swSystem'};
    if (m[which]) { var b=document.getElementById(m[which]); if(b) b.checked=!checked; }
  }
};

// ── Schedule ────────────────────────────────────────────────
var fetchSchedule = async function() {
  try {
    var d = await (await fetch('/schedule')).json();
    document.getElementById('syncBanner').classList.toggle('show', !d.time_synced);
    var list = document.getElementById('schedList');
    if (!d.entries.length) { list.innerHTML = '<div class="empty-note">No scheduled times yet — add one below</div>'; return; }
    list.innerHTML = d.entries.map(function(e){
      var hh=String(e.hour).padStart(2,'0'), mm=String(e.minute).padStart(2,'0');
      return '<div class="sched-item">'
        + '<div class="sched-time">'+hh+':'+mm+'</div>'
        + '<div class="sched-meta">Runs '+fmtDur(e.duration)+(e.enabled?'':' · disabled')+'</div>'
        + '<label class="switch"><input type="checkbox" '+(e.enabled?'checked':'')+' onchange="toggleSchedule('+e.idx+','+e.hour+','+e.minute+','+e.duration+',this.checked)"><span class="strack"></span></label>'
        + '<button class="sched-del" onclick="deleteSchedule('+e.idx+')"><svg viewBox="0 0 24 24" fill="none" stroke="currentColor" stroke-width="2" stroke-linecap="round" stroke-linejoin="round"><path d="M3 6h18M8 6V4a2 2 0 0 1 2-2h4a2 2 0 0 1 2 2v2m3 0-1 14a2 2 0 0 1-2 2H7a2 2 0 0 1-2-2L4 6"/></svg></button>'
        + '</div>';
    }).join('');
  } catch(e) { showToast('⚠ No connection',true); }
};
var addSchedule = async function() {
  var t = document.getElementById('schedTime').value;
  var dur = parseInt(document.getElementById('schedDur').value, 10);
  if (!t) { showToast('⚠ Pick a time',true); return; }
  if (!(dur>=MIN_SEC && dur<=MAX_SEC)) { showToast('⚠ Duration must be 5–3600s',true); return; }
  var parts = t.split(':');
  try {
    await fetch('/scheduleSet?hour='+parts[0]+'&minute='+parts[1]+'&duration='+dur+'&enabled=1');
    showToast('✓ Schedule added'); fetchSchedule();
  } catch(e) { showToast('⚠ No connection',true); }
};
var toggleSchedule = async function(idx, hour, minute, duration, enabled) {
  try { await fetch('/scheduleSet?idx='+idx+'&hour='+hour+'&minute='+minute+'&duration='+duration+'&enabled='+(enabled?1:0)); fetchSchedule(); }
  catch(e) { showToast('⚠ No connection',true); }
};
var deleteSchedule = async function(idx) {
  try { await fetch('/scheduleDelete?idx='+idx); showToast('✓ Removed'); fetchSchedule(); }
  catch(e) { showToast('⚠ No connection',true); }
};

// ── Logs ────────────────────────────────────────────────────
var fmtAgo = function(sec) {
  if (sec<60) return sec+'s ago';
  if (sec<3600) return Math.floor(sec/60)+'m ago';
  if (sec<86400) return Math.floor(sec/3600)+'h ago';
  return Math.floor(sec/86400)+'d ago';
};
var renderLogList = function(el, entries, limit) {
  if (!entries.length) { el.innerHTML = '<div class="empty-note">No activity yet</div>'; return; }
  el.innerHTML = entries.slice(0, limit||entries.length).map(function(e){
    return '<div class="log-item"><span>'+e.msg+'</span><span class="log-ago">'+fmtAgo(e.ago)+'</span></div>';
  }).join('');
};
var fetchLogs = async function() {
  try {
    var d = await (await fetch('/logs')).json();
    renderLogList(document.getElementById('logList'), d);
    renderLogList(document.getElementById('dashLogList'), d, 5);
    var vab=document.getElementById('dashViewAllBtn'); if (vab) vab.style.display = d.length>5 ? '' : 'none';
  } catch(e) {}
};

// ── Device Info ─────────────────────────────────────────────
var fmtUptime = function(sec) {
  var d=Math.floor(sec/86400), h=Math.floor((sec%86400)/3600), m=Math.floor((sec%3600)/60);
  if (d>0) return d+'d '+h+'h '+m+'m';
  if (h>0) return h+'h '+m+'m';
  return m+'m';
};
var fetchDeviceInfo = async function() {
  try {
    var d = await (await fetch('/deviceinfo')).json();
    document.getElementById('sideFwVer').textContent = d.fw_version;
    document.getElementById('tbWifi').textContent = 'WiFi '+d.rssi+' dBm';
    document.getElementById('tbClock').textContent = d.time_synced ? d.local_time : '--:--:--';
    var sc=document.getElementById('schedClock'); if (sc) sc.textContent = d.time_synced ? d.local_time : 'not synced';
    document.getElementById('diSsid').textContent = d.ssid;
    document.getElementById('diIp').textContent = d.ip;
    document.getElementById('diRssi').textContent = d.rssi+' dBm ('+(d.rssi>-60?'Strong':d.rssi>-75?'Fair':'Weak')+')';
    document.getElementById('diMac').textContent = d.mac;
    document.getElementById('diUptime').textContent = fmtUptime(d.uptime_sec);
    document.getElementById('diHeap').textContent = d.free_heap_kb+' KB';
    var mh=document.getElementById('diMinHeap'); if (mh) mh.textContent = d.min_heap_kb+' KB';
    document.getElementById('diChip').textContent = d.chip_model+' rev '+d.chip_rev;
    document.getElementById('diFw').textContent = d.fw_version;
    document.getElementById('diTime').textContent = d.time_synced ? ('synced · '+d.local_time) : 'waiting for sync…';
    var statUp=document.getElementById('statUptime'); if (statUp) statUp.textContent = fmtUptime(d.uptime_sec);
    var wt = document.getElementById('tileWifiVal');
    if (wt) { wt.textContent = d.rssi>-60?'Strong':d.rssi>-75?'Fair':'Weak'; }
    var bh=document.getElementById('diBootHistory');
    if (bh && d.boot_history) {
      if (d.boot_history.length===0) { bh.textContent = 'No history yet.'; }
      else {
        bh.innerHTML = d.boot_history.map(function(b){
          var bad = (b.reason.indexOf('BROWNOUT')>=0 || b.reason.indexOf('PANIC')>=0 || b.reason.indexOf('watchdog')>=0 || b.reason.indexOf('Watchdog')>=0);
          var color = bad ? '#f66' : (b.reason==='Power-on'||b.reason==='Software (restart button)') ? '#8f8' : '#fa5';
          return '<div style="display:flex;justify-content:space-between;padding:6px 0;border-bottom:1px solid rgba(255,255,255,.06)">'
               + '<span style="color:'+color+'">'+b.reason+'</span>'
               + '<span style="opacity:.6">heap '+b.heap_kb+' KB</span></div>';
        }).join('');
      }
    }
  } catch(e) {}
};
var fetchStatus = async function() { try { applyStatus(await (await fetch('/status')).json()); } catch(e) {} };
var setAll = function(ids, fn) { ids.forEach(function(id){ var el=document.getElementById(id); if(el) fn(el); }); };
var applyStatus = function(d) {
  if (!localOverride.has('pir')   && d.pir_sec)               { settings.pir  =d.pir_sec;       render('pir');   }
  if (!localOverride.has('touch') && d.touch_sec)             { settings.touch=d.touch_sec;     render('touch'); }
  if (!localOverride.has('wifi')  && d.wifi_sec)              { settings.wifi =d.wifi_sec;      render('wifi');  }
  if (!localOverride.has('power') && d.pump_power!==undefined) { settings.power=d.pump_power;   render('power'); }
  if (!localOverride.has('distance1') && d.distance1_cm!==undefined) { settings.distance1=d.distance1_cm; render('distance1'); }
  if (!localOverride.has('distance2') && d.distance2_cm!==undefined) { settings.distance2=d.distance2_cm; render('distance2'); }

  if (d.water_pct !== undefined) {
    var pct=d.water_pct;
    var col = pct>=50?'var(--on)':pct>=20?'var(--warn)':'var(--off)';
    setAll(['tankFillD','tankFillT'], function(el){ el.style.height=pct+'%'; el.style.background=col.indexOf('on')>=0?'linear-gradient(180deg,#34d399,#059669)':col.indexOf('warn')>=0?'linear-gradient(180deg,#fbbf24,#d97706)':'linear-gradient(180deg,#fb7185,#e11d48)'; });
    setAll(['tankPctD','tankPctT','tileWaterVal'], function(el){ el.textContent=pct+'%'; });
    var tw=document.getElementById('tileWater'); if (tw) tw.className='tile'+(pct<20?' bad':pct<50?' warn':'');
    var badge=document.getElementById('tankBadge'), head=document.getElementById('tankHeadline'), sub=document.getElementById('tankSub');
    if (badge) {
      var lvl = pct<20?'Critical':pct<50?'Low':'Good';
      badge.textContent = lvl; badge.className='badge '+(pct<20?'err':pct<50?'muted':'ok');
      if (head) head.textContent = pct+'% full';
      if (sub) sub.textContent = d.water_attached===false ? 'Sensor detached in this build — level locked at 50%.' : (pct<20?'Refill now — the pump will refuse to start below this.':pct<50?'Getting low — plan a refill soon.':'Tank level looks healthy.');
    }
  }

  var swL1=document.getElementById('swLaser1');  if (swL1  && document.activeElement!==swL1  && d.laser1_enabled!==undefined) swL1.checked=d.laser1_enabled;
  var swL2=document.getElementById('swLaser2');  if (swL2  && document.activeElement!==swL2  && d.laser2_enabled!==undefined) swL2.checked=d.laser2_enabled;
  var swTc=document.getElementById('swTouch');   if (swTc  && document.activeElement!==swTc  && d.touch_enabled!==undefined)  swTc.checked=d.touch_enabled;
  var swTM=document.getElementById('swTestMode'); if (swTM && document.activeElement!==swTM && d.test_mode!==undefined) swTM.checked=d.test_mode;
  var swSys=document.getElementById('swSystem'); if (swSys && document.activeElement!==swSys && d.system_enabled!==undefined) swSys.checked=d.system_enabled;
  var tb=document.getElementById('waterTestBadge'); if(tb) tb.classList.toggle('show', !!d.test_mode);

  var s1Err = (d.sensor1_ok===false);
  var s1DistText = s1Err ? 'ERR' : (d.live_dist1_cm>=0 ? d.live_dist1_cm+' cm' : '--');
  setAll(['hwS1Dist','dashS1Dist'], function(el){ el.textContent=s1DistText; });

  var s2Detached = (d.sensor2_attached===false);
  var s2Err = (d.sensor2_ok===false);
  var s2DistText = s2Detached ? '—' : (s2Err ? 'ERR' : (d.live_dist2_cm>=0 ? d.live_dist2_cm+' cm' : '--'));
  setAll(['hwS2Dist','dashS2Dist'], function(el){ el.textContent=s2DistText; });

  var s1s=document.getElementById('dbgS1Status');
  if (s1s && d.sensor1_ok!==undefined) { s1s.textContent = d.sensor1_ok ? 'Connected' : 'Error'; s1s.className = 'badge '+(d.sensor1_ok ? 'ok' : 'err'); }
  var s2s=document.getElementById('dbgS2Status');
  if (s2s) {
    if (d.sensor2_attached===false) { s2s.textContent='Detached'; s2s.className='badge muted'; }
    else if (d.sensor2_ok!==undefined) { s2s.textContent = d.sensor2_ok ? 'Connected' : 'Error'; s2s.className = 'badge '+(d.sensor2_ok ? 'ok' : 'err'); }
  }
  var sensorsOk = d.sensor1_ok!==false && (d.sensor2_attached===false || d.sensor2_ok!==false);
  if (d.pump_power!==undefined) { var sp=document.getElementById('statPower'); if (sp) sp.textContent=d.pump_power+'/10'; }
  var l2=document.getElementById('lblLaser2');
  if (l2 && d.sensor2_attached===false) l2.textContent='DETACHED in this build';
  var ltm=document.getElementById('lblTestMode');
  if (ltm && d.water_attached===false) ltm.innerHTML='Water sensor DETACHED in this build. Test mode is locked ON — level fixed at 50%.';

  window._systemOff  = (d.system_enabled===false);
  window._pumpLocked = d.locked;
  var sysIcon=document.getElementById('btnSystemIcon');
  if (sysIcon) { sysIcon.classList.toggle('state-on', !window._systemOff); sysIcon.classList.toggle('state-off', window._systemOff); }
  var mob=document.getElementById('masterOffBanner'); if(mob) mob.classList.toggle('show',window._systemOff);
  setAll(['btnOn','btnOnP'],   function(el){ el.classList.toggle('btn-locked', !!d.locked||window._systemOff); });
  setAll(['btnInf','btnInfP'], function(el){ el.classList.toggle('btn-locked', !!d.locked||window._systemOff); });
  var sideDot=document.getElementById('sideHealthDot'), sideTxt=document.getElementById('sideHealthText');
  if (sideDot) { var healthy = !window._systemOff && !d.empty_error && sensorsOk; sideDot.classList.toggle('bad', !healthy); }
  if (sideTxt) sideTxt.textContent = window._systemOff ? 'System Off' : d.empty_error ? 'Water Low' : !sensorsOk ? 'Sensor Error' : 'System Healthy';

  setAll(['pumpPowerRO'], function(el){ el.textContent = d.pump_power+'/10'; });
  setAll(['pumpWifiRO'],  function(el){ el.textContent = fmtDur(d.wifi_sec||settings.wifi); });

  var banner=document.getElementById('errorBanner');
  var tilePump=document.getElementById('tilePumpVal');

  var setChip = function(text, cls) {
    setAll(['statusChipText','statusChipText2'], function(el){ el.textContent=text; });
    setAll(['statusChip','statusChip2'], function(el){ el.className='status-chip'+(cls?' '+cls:''); });
  };
  var setHeadline = function(text, subText) {
    setAll(['pumpLabel','pumpLabel2'], function(el){ el.textContent=text; });
    setAll(['pumpSub','pumpSub2'], function(el){ el.textContent=subText; });
  };

  if (window._systemOff && !d.running) {
    setChip('System Off'); setHeadline('System is OFF', 'Pump disabled');
    if (tilePump) tilePump.textContent='Off';
    if(banner) banner.classList.remove('show'); stopTicks(); resetTimerUI(); return;
  }
  if (d.empty_error) {
    if(banner) banner.classList.add('show');
    setChip('Water Low'); setHeadline('Water level low!', 'Refill the reservoir');
    if (tilePump) tilePump.textContent='Blocked';
    stopTicks(); resetTimerUI(); return;
  }
  if(banner) banner.classList.remove('show');

  var srcMap={PIR:'Laser sensor',TOUCH:'Touch sensor',WIFI:'App',SCHED:'Schedule'};
  if (d.running && d.continuous) {
    setChip('Running', ''); setHeadline('Running continuously', (srcMap[d.source]||d.source)+' · Stop via app');
    if (tilePump) tilePump.textContent='Running';
    setAll(['timerWrap','timerWrap2'], function(el){ el.classList.add('active'); });
    setAll(['timerLabel','timerLabel2'], function(el){ el.textContent='Elapsed'; });
    setAll(['barFill','barFill2'], function(el){ el.classList.add('inf'); });
    setAll(['timerText','timerText2'], function(el){ el.classList.add('inf'); });
    elapsedStart=Date.now()-d.elapsed_ms; stopTimerTick();
    if (!elapsedTick) elapsedTick=setInterval(function(){ setAll(['timerText','timerText2'], function(el){el.textContent=fmtMs(Date.now()-elapsedStart);}); },500);
    return;
  }
  if (d.running) {
    setChip('Running', ''); setHeadline('Pump is running', 'Triggered by: '+(srcMap[d.source]||d.source)+' · Power '+d.pump_power+'/10');
    if (tilePump) tilePump.textContent='Running';
    setAll(['timerWrap','timerWrap2'], function(el){ el.classList.add('active'); });
    setAll(['timerLabel','timerLabel2'], function(el){ el.textContent='Pump running'; });
    setAll(['barFill','barFill2'], function(el){ el.classList.remove('inf'); });
    setAll(['timerText','timerText2'], function(el){ el.classList.remove('inf'); });
    lastDurationMs=d.duration_ms;
    var rem=Math.max(0,d.duration_ms-d.elapsed_ms);
    pumpEndTime=Date.now()+rem;
    var pctDone=Math.min(100,d.elapsed_ms/d.duration_ms*100);
    setAll(['barFill','barFill2'], function(el){ el.style.width=pctDone+'%'; });
    setAll(['timerText','timerText2'], function(el){ el.textContent=fmtMs(rem); });
    stopElapsedTick();
    if (!timerTick) timerTick=setInterval(function(){
      var r2=Math.max(0,pumpEndTime-Date.now());
      var p2=Math.min(100,(lastDurationMs-r2)/lastDurationMs*100);
      setAll(['barFill','barFill2'], function(el){ el.style.width=p2+'%'; });
      setAll(['timerText','timerText2'], function(el){ el.textContent=fmtMs(r2); });
      if(r2<=0) stopTimerTick();
    },400);
    return;
  }
  window._pumpLocked=false;
  setChip('Ready', ''); setHeadline('Pump is off', 'Waiting for a trigger…');
  if (tilePump) tilePump.textContent='Ready';
  stopTicks(); resetTimerUI();
};
var stopTimerTick=function(){ if(timerTick){clearInterval(timerTick);timerTick=null;} };
var stopElapsedTick=function(){ if(elapsedTick){clearInterval(elapsedTick);elapsedTick=null;} };
var stopTicks=function(){ stopTimerTick(); stopElapsedTick(); };
var resetTimerUI=function(){
  setAll(['timerWrap','timerWrap2'], function(el){ el.classList.remove('active'); });
  setAll(['barFill','barFill2'], function(el){ el.classList.remove('inf'); el.style.width='0%'; });
  setAll(['timerText','timerText2'], function(el){ el.classList.remove('inf'); el.textContent='0:00'; });
};
var fmtMs=function(ms){ var s=Math.ceil(ms/1000),m=Math.floor(s/60); return m+':'+String(s%60).padStart(2,'0'); };
var showToast=function(msg,isErr){
  var t=document.getElementById('toast'); t.textContent=msg;
  t.className='toast show'+(isErr?' err':'');
  setTimeout(function(){t.classList.remove('show');},3000);
};
fetchStatus();
fetchDeviceInfo();
fetchLogs();
setInterval(fetchStatus, 400);       // matches firmware's faster sample rate
setInterval(fetchDeviceInfo, 5000);  // clock/RSSI/uptime — no need for 400ms cadence
</script>
</body>
)rawliteral";

// ── Web handlers ──────────────────────────────────────────────
void handleRoot()   { server.send_P(200,"text/html",INDEX_HTML); }
void handleStatus() { server.send(200,"application/json",buildStatusJson()); }
void handleLogo()    { server.send_P(200, "image/jpeg", (const char*)LOGO_JPG, LOGO_JPG_LEN); }
void handleManifest() {
  String m = "{\"name\":\"PooKooli Fountain\",\"short_name\":\"PooKooli\","
             "\"start_url\":\"/\",\"display\":\"standalone\","
             "\"background_color\":\"#0a0c12\",\"theme_color\":\"#0a0c12\","
             "\"icons\":[{\"src\":\"/logo.jpg\",\"sizes\":\"192x192\",\"type\":\"image/jpeg\"}]}";
  server.send(200, "application/json", m);
}

void handlePumpCmd() {
  if (!systemEnabled) { pumpOFF(); server.send(200,"application/json",buildStatusJson()); return; }
  if (!server.hasArg("cmd")) { server.send(400,"text/plain","Missing cmd"); return; }
  String cmd = server.arg("cmd");
  if (cmd=="on") {
    if (pumpRunning && pumpSource!=SRC_WIFI) { server.send(200,"application/json",buildStatusJson()); return; }
    if (!hasWater()) { triggerBlocked(SRC_WIFI); logEvent("Pump blocked — water low (App)"); }
    else { startPump(SRC_WIFI, wifiDurationMs); logEvent("Pump started — App"); }
  } else if (cmd=="continuous") {
    if (pumpRunning && pumpSource!=SRC_WIFI) { server.send(200,"application/json",buildStatusJson()); return; }
    if (!hasWater()) { triggerBlocked(SRC_WIFI); logEvent("Pump blocked — water low (App)"); }
    else { startPumpForever(SRC_WIFI); logEvent("Pump started — App (continuous)"); }
  } else if (cmd=="off") {
    if (pumpRunning) logEvent("Pump stopped — App");
    pumpOFF(); tankLowError=false;
  }
  server.send(200,"application/json",buildStatusJson());
}

void handleSettings() {
  bool changed=false;
  if (server.hasArg("pir"))       { long v=server.arg("pir").toInt();       if(v>=MIN_SEC&&v<=MAX_SEC)                 { pirDurationMs =v*1000UL;        changed=true; } }
  if (server.hasArg("touch"))     { long v=server.arg("touch").toInt();     if(v>=MIN_SEC&&v<=MAX_SEC)                 { touchDurationMs=v*1000UL;       changed=true; } }
  if (server.hasArg("wifi"))      { long v=server.arg("wifi").toInt();      if(v>=MIN_SEC&&v<=MAX_SEC)                 { wifiDurationMs=v*1000UL;        changed=true; } }
  if (server.hasArg("power"))     { int  v=server.arg("power").toInt();     if(v>=1&&v<=10)                            { pumpPower=(uint8_t)v;           changed=true; } }
  if (server.hasArg("distance1")) { int  v=server.arg("distance1").toInt(); if(v>=MIN_DISTANCE_CM&&v<=MAX_DISTANCE_CM) { triggerDistance1Cm=(uint8_t)v;  changed=true; } }
  if (server.hasArg("distance2")) { int  v=server.arg("distance2").toInt(); if(v>=MIN_DISTANCE_CM&&v<=MAX_DISTANCE_CM) { triggerDistance2Cm=(uint8_t)v;  changed=true; } }
  if (changed) { saveSettings(); logEvent("Settings updated"); }
  String j="{\"ok\":true,\"pir_sec\":"+String(pirDurationMs/1000)
           +",\"touch_sec\":"+String(touchDurationMs/1000)
           +",\"wifi_sec\":"+String(wifiDurationMs/1000)
           +",\"pump_power\":"+String(pumpPower)
           +",\"distance1_cm\":"+String(triggerDistance1Cm)
           +",\"distance2_cm\":"+String(triggerDistance2Cm)+"}";
  server.send(200,"application/json",j);
}

void handleToggle() {
  if (!server.hasArg("which")||!server.hasArg("state")) { server.send(400,"text/plain","Missing args"); return; }
  String which = server.arg("which");
  bool   state = (server.arg("state")=="1"||server.arg("state")=="true");
  bool   persist = true;
  if      (which=="system") { systemEnabled=state; logEvent(state?"System turned on":"System turned off"); if(!systemEnabled){pumpOFF();tankLowError=false;} }
  else if (which=="laser1") { laser1Enabled=state; }
  else if (which=="laser2") { laser2Enabled=state; }
  else if (which=="touch")  { touchEnabled=state; }
  else if (which=="testmode") {
    persist = false;    // deliberately NOT saved to flash
    if (!state && !WATER_ATTACHED) {
      // water sensor isn't wired — refuse to leave test mode
      testMode = true;
      Serial.println("[Test] Water sensor DETACHED — test mode stays ON");
    } else {
      testMode = state;
      if (testMode) {
        waterPct = 50;
        Serial.println("[Test] WATER TEST MODE ON — level forced to 50%");
      } else {
        readWaterLevel();
        Serial.println("[Test] WATER TEST MODE OFF — real sensor readings resumed");
      }
    }
  }
  else { server.send(400,"text/plain","Unknown which"); return; }
  if (persist) saveSettings();
  server.send(200,"application/json",buildStatusJson());
}

void handleRestart() {
  pumpOFF();
  server.send(200,"application/json","{\"restarting\":true}");
  delay(300);
  Serial.println("[System] Restarting via web");
  ESP.restart();
}

void handleI2CRecover() {
  Serial.println("[Recovery] Manual I2C bus recovery triggered via web app");
  esp_task_wdt_reset();
  Wire.end();               // release the bus before bit-banging it directly
  recoverI2CBus(21, 22);
  Wire.begin(21, 22);
  Wire.setClock(100000);
  delay(50);
  initI2CDevices();         // full re-init: both sensors + OLED
  esp_task_wdt_reset();
  logEvent("I2C bus recovered manually");
  server.send(200,"application/json",buildStatusJson());
}

// ── Device Info ──────────────────────────────────────────────
String buildDeviceInfoJson() {
  unsigned long upSec = millis() / 1000UL;
  String localTime = "";
  if (timeSynced) {
    struct tm ti;
    if (getLocalTime(&ti, 5)) {
      char buf[9]; snprintf(buf, sizeof(buf), "%02d:%02d:%02d", ti.tm_hour, ti.tm_min, ti.tm_sec);
      localTime = String(buf);
    }
  }
  String j = "{";
  j += "\"ssid\":\""        + String(WIFI_SSID) + "\",";
  j += "\"ip\":\""          + WiFi.localIP().toString() + "\",";
  j += "\"rssi\":"          + String(WiFi.RSSI()) + ",";
  j += "\"mac\":\""         + WiFi.macAddress() + "\",";
  j += "\"uptime_sec\":"    + String(upSec) + ",";
  j += "\"free_heap_kb\":"  + String(ESP.getFreeHeap()/1024) + ",";
  j += "\"min_heap_kb\":"   + String(minFreeHeapSeen==UINT32_MAX ? ESP.getFreeHeap()/1024 : minFreeHeapSeen/1024) + ",";
  j += "\"boot_history\":"  + buildBootHistoryJson() + ",";
  j += "\"chip_model\":\""  + String(ESP.getChipModel()) + "\",";
  j += "\"chip_rev\":"      + String(ESP.getChipRevision()) + ",";
  j += "\"fw_version\":\""  + String(FW_VERSION) + "\",";
  j += "\"time_synced\":"   + String(timeSynced?"true":"false") + ",";
  j += "\"local_time\":\""  + localTime + "\"";
  j += "}";
  return j;
}
void handleDeviceInfo() { server.send(200,"application/json",buildDeviceInfoJson()); }

// ── Recent activity log ─────────────────────────────────────
String buildLogsJson() {
  unsigned long nowMs = millis();
  String j = "[";
  bool first = true;
  // Ring buffer holds `logCount` valid entries; the most recent one is
  // always the slot just before logHead (wrapping), walk backwards from
  // there so the response comes back newest-first.
  for (uint8_t n = 0; n < logCount; n++) {
    uint8_t idx = (logHead + MAX_LOG_ENTRIES - 1 - n) % MAX_LOG_ENTRIES;
    if (!first) j += ",";
    first = false;
    unsigned long agoSec = (nowMs - eventLog[idx].ms) / 1000UL;
    String msg = eventLog[idx].msg;
    msg.replace("\"", "'");   // defensive — all messages are static literals today, but keep JSON valid regardless
    j += "{\"ago\":" + String(agoSec) + ",\"msg\":\"" + msg + "\"}";
  }
  j += "]";
  return j;
}
void handleLogs() { server.send(200,"application/json",buildLogsJson()); }

// ── Schedule ─────────────────────────────────────────────────
String buildScheduleJson() {
  String j = "{\"time_synced\":" + String(timeSynced?"true":"false") + ",\"entries\":[";
  for (uint8_t i = 0; i < scheduleCount; i++) {
    if (i) j += ",";
    j += "{\"idx\":" + String(i)
       + ",\"hour\":" + String(schedules[i].hour)
       + ",\"minute\":" + String(schedules[i].minute)
       + ",\"duration\":" + String(schedules[i].durationSec)
       + ",\"enabled\":" + String(schedules[i].enabled?"true":"false") + "}";
  }
  j += "]}";
  return j;
}
void handleScheduleGet() { server.send(200,"application/json",buildScheduleJson()); }

void handleScheduleSet() {
  if (!server.hasArg("hour") || !server.hasArg("minute") || !server.hasArg("duration")) {
    server.send(400,"text/plain","Missing args"); return;
  }
  int hour = server.arg("hour").toInt();
  int minute = server.arg("minute").toInt();
  int duration = server.arg("duration").toInt();
  bool enabled = !server.hasArg("enabled") || server.arg("enabled")=="1" || server.arg("enabled")=="true";
  if (hour<0||hour>23||minute<0||minute>59||duration<MIN_SEC||duration>MAX_SEC) {
    server.send(400,"text/plain","Value out of range"); return;
  }
  int idx = server.hasArg("idx") ? server.arg("idx").toInt() : -1;
  char lbl[6]; snprintf(lbl, sizeof(lbl), "%02d:%02d", hour, minute);
  if (idx >= 0 && idx < (int)scheduleCount) {
    schedules[idx] = { (uint8_t)hour, (uint8_t)minute, (uint16_t)duration, enabled, false };
    logEvent(String("Schedule ") + lbl + " updated");
  } else {
    if (scheduleCount >= MAX_SCHEDULES) { server.send(400,"text/plain","Schedule full"); return; }
    schedules[scheduleCount++] = { (uint8_t)hour, (uint8_t)minute, (uint16_t)duration, enabled, false };
    logEvent(String("Schedule ") + lbl + " added");
  }
  saveSettings();
  server.send(200,"application/json",buildScheduleJson());
}

void handleScheduleDelete() {
  if (!server.hasArg("idx")) { server.send(400,"text/plain","Missing idx"); return; }
  int idx = server.arg("idx").toInt();
  if (idx < 0 || idx >= (int)scheduleCount) { server.send(400,"text/plain","Bad idx"); return; }
  char lbl[6]; snprintf(lbl, sizeof(lbl), "%02d:%02d", schedules[idx].hour, schedules[idx].minute);
  for (uint8_t i = idx; i < scheduleCount - 1; i++) schedules[i] = schedules[i+1];
  scheduleCount--;
  schedules[scheduleCount] = { 0, 0, 0, false, false };
  logEvent(String("Schedule ") + lbl + " removed");
  saveSettings();
  server.send(200,"application/json",buildScheduleJson());
}

// ── I2C bus recovery ───────────────────────────────────────────
// If a device gets interrupted mid-transaction (noise, brief power
// glitch, an unplugged sensor mid-read), it can leave SDA stuck LOW,
// jamming the entire bus for every device on it. This manually pulses
// SCL up to 9 times to force a stuck device to release SDA, then sends
// a manual STOP condition. Standard I2C bus recovery procedure — must
// be called with Wire NOT active (call Wire.end() first if it was).
void recoverI2CBus(int sdaPin, int sclPin) {
  Serial.printf("[Recovery] I2C bus recovery on SDA=%d SCL=%d...\n", sdaPin, sclPin);
  pinMode(sdaPin, INPUT_PULLUP);
  pinMode(sclPin, OUTPUT);

  bool stuckBefore = (digitalRead(sdaPin) == LOW);
  if (stuckBefore) Serial.println("[Recovery] SDA was stuck LOW — clearing...");

  for (int i = 0; i < 9; i++) {
    digitalWrite(sclPin, LOW);  delayMicroseconds(5);
    digitalWrite(sclPin, HIGH); delayMicroseconds(5);
    if (digitalRead(sdaPin) == HIGH) break;
  }

  // Manual STOP condition: SDA goes LOW->HIGH while SCL is HIGH
  pinMode(sdaPin, OUTPUT);
  digitalWrite(sdaPin, LOW);  delayMicroseconds(5);
  digitalWrite(sclPin, HIGH); delayMicroseconds(5);
  digitalWrite(sdaPin, HIGH); delayMicroseconds(5);

  Serial.printf("[Recovery] Done. SDA now: %s\n",
    digitalRead(sdaPin)==HIGH ? "HIGH (ok)" : "STILL LOW (bus may be damaged)");
}

// ── I2C device init (sensors + OLED) ────────────────────────────
// Pulled out of setup() so it can also be re-run at runtime from the
// web app's "Recover I2C Bus" button, without a full board restart.
void initI2CDevices() {
  tof1Ok = false;
  tof2Ok = false;

  digitalWrite(PIN_XSHUT1, LOW);
  digitalWrite(PIN_XSHUT2, LOW);
  delay(50);

  // Sensors first, on a quiet bus, while they're most fragile (just out
  // of hard reset). OLED goes LAST — its init traffic/power draw was
  // disturbing the sensors when it ran first, causing both to fail.
  digitalWrite(PIN_XSHUT1, HIGH);
  delay(10);
  if (sensor1.begin(VL53_ADDR_1)) {
    tof1Ok = true;
    // Fast timing budget (20ms — the sensor's practical minimum) instead
    // of the ~33ms+ default. A cat-proximity trigger doesn't need the
    // extra averaging; this directly cuts trigger latency since every
    // rangingTest() call blocks for roughly this long.
    sensor1.setMeasurementTimingBudgetMicroSeconds(20000);
    Serial.println("[VL53L0X] Sensor #1 OK at 0x30 (20ms timing budget)");
  } else {
    Serial.println("[VL53L0X] Sensor #1 FAILED");
  }

  if (SENSOR2_ATTACHED) {
    digitalWrite(PIN_XSHUT2, HIGH);
    delay(10);
    if (sensor2.begin(VL53_ADDR_2)) {
      tof2Ok = true;
      sensor2.setMeasurementTimingBudgetMicroSeconds(20000);
      Serial.println("[VL53L0X] Sensor #2 OK at 0x31 (20ms timing budget)");
    } else {
      Serial.println("[VL53L0X] Sensor #2 FAILED");
    }
  } else {
    Serial.println("[VL53L0X] Sensor #2 DETACHED in this build — skipped");
  }

  if (OLED_ATTACHED) {
    if (!oled.begin(SSD1306_SWITCHCAPVCC, OLED_ADDR)) {
      Serial.println("[OLED] Not found — check wiring/address (0x3C)");
    } else {
      oled.clearDisplay(); oled.setTextColor(SSD1306_WHITE); oled.setTextSize(1);
      oled.setCursor(4,  8); oled.print(F("PooKooli X " FW_VERSION));
      oled.setCursor(4, 20); oled.print(F("Starting..."));
      oled.display();
      Serial.println("[OLED] OK at 0x3C");
    }
  }
}

// ── Setup ─────────────────────────────────────────────────────
void setup() {
  // Claim both XSHUT pins and force them LOW FIRST — before Serial,
  // before the pump, before anything else. Every millisecond this is
  // delayed is a millisecond the sensors' pins can float and let a
  // sensor start powering up early, which caused the random boot
  // failures (race condition: whichever sensor "woke up" first grabbed
  // 0x29, so results varied between resets).
  pinMode(PIN_XSHUT1, OUTPUT);
  pinMode(PIN_XSHUT2, OUTPUT);
  digitalWrite(PIN_XSHUT1, LOW);
  digitalWrite(PIN_XSHUT2, LOW);

  Serial.begin(115200);
  delay(300);
  Serial.println("\n=== PooKooli Fountain X " FW_VERSION " ===");
  recordBootReason();   // log WHY we just booted — survives even a crash loop

  ledcAttach(PIN_PUMP, LEDC_FREQ_HZ, LEDC_RESOLUTION);
  pumpOFF();   // safety: pump OFF on every boot

  pinMode(PIN_WATER_ADC, INPUT);
  pinMode(PIN_TOUCH, INPUT);   // actively driven by the module — no pull-up needed

  // Hold both sensors in reset a little longer to guarantee a clean,
  // fully-discharged start (50ms, up from 10ms — some breakout boards
  // have their own onboard regulator with a slower power-down curve)
  delay(50);

  // Preventive bus recovery BEFORE the first Wire.begin() — clears any
  // stuck-SDA condition left over from a previous power cycle, so every
  // boot starts from a guaranteed-clean bus without needing the web
  // button pressed manually.
  recoverI2CBus(21, 22);

  Wire.begin(21, 22);
  Wire.setClock(100000);   // 100kHz — reliable with typical wiring/resistors

  initI2CDevices();

  // Boot connectivity summary — same result the web app shows
  Serial.println("----------------------------------------");
  Serial.printf("[BOOT CHECK] Sensor #1 (0x30): %s\n",
    tof1Ok ? "OK" : "ERROR - not responding, check wiring/power");
  Serial.printf("[BOOT CHECK] Sensor #2 (0x31): %s\n",
    !SENSOR2_ATTACHED ? "DETACHED (not in this build)"
                      : (tof2Ok ? "OK" : "ERROR - not responding, check wiring/power"));
  Serial.printf("[BOOT CHECK] Water sensor: %s\n",
    WATER_ATTACHED ? "attached" : "DETACHED — test mode locked ON (50%)");
  Serial.printf("[BOOT CHECK] OLED: %s\n",
    !OLED_ATTACHED ? "DETACHED (not in this build)" : "attached (see [OLED] line above)");
  Serial.println("----------------------------------------");

  loadSettings();
  readWaterLevel();

  WiFi.mode(WIFI_STA);
  // Lower TX power before connecting — full power (~20dBm default) draws
  // a sharp current spike right at radio startup, which is a classic
  // brownout trigger when the supply is already loaded by every other
  // module running simultaneously. 11dBm is still plenty for typical
  // home WiFi range at close-to-moderate distance.
  WiFi.setTxPower(WIFI_POWER_11dBm);
  delay(50);  // let the rail settle after the mode-set current draw too
  WiFi.begin(WIFI_SSID, WIFI_PASSWORD);
  Serial.printf("Connecting to %s", WIFI_SSID);
  int tries=0;
  while (WiFi.status()!=WL_CONNECTED && tries<30) { delay(500); Serial.print("."); tries++; }
  if (WiFi.status()==WL_CONNECTED) {
    Serial.printf("\n✓ http://%s\n", WiFi.localIP().toString().c_str());
    configTime(TZ_OFFSET_SEC, 0, "pool.ntp.org", "time.nist.gov");   // async — timeSynced flips true once it lands
    Serial.println("[NTP] Sync requested (Schedule feature)");
  } else
    Serial.println("\n✗ WiFi failed — check credentials/signal");

  server.on("/",         handleRoot);
  server.on("/logo.jpg", handleLogo);
  server.on("/manifest.json", handleManifest);
  server.on("/status",   handleStatus);
  server.on("/pump",     handlePumpCmd);
  server.on("/settings", handleSettings);
  server.on("/toggle",   handleToggle);
  server.on("/restart",  handleRestart);
  server.on("/i2crecover", handleI2CRecover);
  server.on("/deviceinfo", handleDeviceInfo);
  server.on("/logs",       handleLogs);
  server.on("/schedule",   handleScheduleGet);
  server.on("/scheduleSet",    handleScheduleSet);
  server.on("/scheduleDelete", handleScheduleDelete);
  server.begin();
  Serial.println("[Web] Server ready");

  // Newer ESP32 Arduino cores auto-start a default task watchdog before
  // this code ever runs — calling esp_task_wdt_init() on top of that
  // used to fail silently (logged "already initialized" and just
  // continued), which meant our intended 10s timeout never actually
  // took effect and whatever shorter default was already running stayed
  // active instead. That's what caused a real crash: the I2C recovery
  // sequence took longer than that hidden default, the watchdog fired,
  // and the board panicked/rebooted mid-recovery. Deinit whatever's
  // already there first, so our own config is what's genuinely active.
  esp_task_wdt_deinit();
  esp_task_wdt_config_t wdtCfg = {
    .timeout_ms    = WDT_TIMEOUT_SEC * 1000,
    .idle_core_mask = 0,
    .trigger_panic  = true
  };
  esp_err_t wdtErr = esp_task_wdt_init(&wdtCfg);
  esp_task_wdt_add(NULL);
  Serial.printf("[WDT] Armed (%ds) — init result: %s\n", WDT_TIMEOUT_SEC,
    wdtErr == ESP_OK ? "OK, our config is active" : "FAILED, see error above");
}

// ── Loop ──────────────────────────────────────────────────────
void loop() {
  esp_task_wdt_reset();
  server.handleClient();
  unsigned long now = millis();

  uint32_t freeHeapNow = ESP.getFreeHeap();
  if (freeHeapNow < minFreeHeapSeen) minFreeHeapSeen = freeHeapNow;

  // One-time NTP sync check (5ms timeout — never blocks the loop). Runs
  // regardless of systemEnabled so Device Info / Schedule reflect sync
  // state even while the system is switched off.
  if (!timeSynced) {
    struct tm ti;
    if (getLocalTime(&ti, 5)) timeSynced = true;
  }

  if (now - lastWaterRead >= WATER_SAMPLE_MS) {
    lastWaterRead = now;
    readWaterLevel();
  }

  // Refresh cached laser distances (runs even with system OFF, for debugging)
  if (now - lastDistRead >= DIST_SAMPLE_MS) {
    lastDistRead = now;
    readDistances();
  }

  // Periodic Serial distance report (mirrors the web app debug card)
  if (now - lastDistPrint >= DIST_PRINT_MS) {
    lastDistPrint = now;
    char d1[12], d2[12];
    if (!tof1Ok)               strcpy(d1, "ERR");
    else if (lastDist1Cm >= 0) snprintf(d1, sizeof(d1), "%ldcm", lastDist1Cm);
    else                       strcpy(d1, "--");
    if (!SENSOR2_ATTACHED)     strcpy(d2, "DET");
    else if (!tof2Ok)          strcpy(d2, "ERR");
    else if (lastDist2Cm >= 0) snprintf(d2, sizeof(d2), "%ldcm", lastDist2Cm);
    else                       strcpy(d2, "--");
    Serial.printf("[Dist] S1=%s  S2=%s\n", d1, d2);
  }

  if (!systemEnabled) {
    if (pumpRunning) { Serial.println("[System] Master OFF"); pumpOFF(); logEvent("Pump stopped — system turned off"); }
    laserCandidate = false;
    touchCandidate = false;
    if (now-lastOledUpdate >= OLED_REFRESH_MS) { lastOledUpdate=now; updateOled(); }
    delay(50); return;
  }

  if (tankLowError && (now-emptyErrorTime > EMPTY_BLINK_MS)) tankLowError=false;

  if (pumpRunning && !pumpContinuous && (now-pumpStartTime >= pumpDuration)) {
    bool wasLaser = (pumpSource==SRC_PIR);
    bool underSafetyCap = (now - laserFirstTriggerTime) < MAX_LASER_RUNTIME_MS;
    if (wasLaser && catStillPresent() && hasWater() && underSafetyCap) {
      pumpStartTime = now;   // renew: same duration, fresh countdown
      Serial.println("[Pump] Cat still in range — renewing timer for another round");
    } else {
      if (wasLaser && !underSafetyCap) {
        Serial.println("[Pump] Safety cap reached (5 min) — stopping regardless of sensor state");
      } else {
        Serial.println("[Pump] Timer done");
      }
      if (wasLaser) lastLaserEndTime=now;
      pumpOFF();
      logEvent("Pump stopped — timer ended");
      if (wasLaser && !hasWater()) { triggerBlocked(SRC_PIR); logEvent("Pump blocked — water low (Laser)"); }
    }
  }

  if (pumpRunning && pumpContinuous && !hasWater()) {
    Serial.printf("[Pump] Continuous — water low (%d%%)\n", waterPct);
    pumpOFF(); triggerBlocked(SRC_NONE);
    logEvent("Pump stopped — water low");
  }

  if (now-lastOledUpdate >= OLED_REFRESH_MS) { lastOledUpdate=now; updateOled(); }

  // Touch: universal manual override. Checked BEFORE the pumpRunning
  // gate below so a touch can stop an already-running pump regardless
  // of what triggered it (laser or app), not just start new runs.
  if (touchStable() && (now-lastTouchTime > TOUCH_DEBOUNCE_MS)) {
    lastTouchTime = now;
    if (pumpRunning) {
      Serial.println("[Touch] Stop");
      if (pumpSource==SRC_PIR) lastLaserEndTime=now;
      pumpOFF();
      logEvent("Pump stopped — Touch");
    } else {
      Serial.println("[Touch] Trigger");
      if (hasWater()) { startPump(SRC_TOUCH, touchDurationMs); logEvent("Pump started — Touch"); }
      else            { triggerBlocked(SRC_TOUCH); logEvent("Pump blocked — water low (Touch)"); }
    }
    delay(50); return;
  }

  if (pumpRunning) { delay(50); return; }

  if (laserStable() && (now-lastLaserEndTime > LASER_LOCKOUT_MS)) {
    Serial.printf("[Laser] Triggered (d1=%dcm d2=%dcm)\n", triggerDistance1Cm, triggerDistance2Cm);
    laserFirstTriggerTime = now;
    if (hasWater()) { startPump(SRC_PIR, pirDurationMs); logEvent("Pump started — Laser"); }
    else            { triggerBlocked(SRC_PIR); logEvent("Pump blocked — water low (Laser)"); }
  }

  // Schedule: fixed daily trigger times. Needs NTP sync (TZ_OFFSET_SEC
  // above) — until then this block is simply skipped, same as any other
  // trigger source being "not ready" yet. Reuses the exact same
  // startPump()/triggerBlocked() functions as every other trigger source,
  // so hasWater(), systemEnabled and the watchdog all apply unchanged.
  if (!pumpRunning && timeSynced && scheduleCount > 0) {
    struct tm ti;
    if (getLocalTime(&ti, 5)) {
      if (ti.tm_yday != lastScheduleDay) {
        lastScheduleDay = ti.tm_yday;
        for (uint8_t i = 0; i < scheduleCount; i++) schedules[i].firedToday = false;
      }
      for (uint8_t i = 0; i < scheduleCount; i++) {
        ScheduleEntry &e = schedules[i];
        if (e.enabled && !e.firedToday && ti.tm_hour == e.hour && ti.tm_min == e.minute) {
          e.firedToday = true;
          char lbl[6]; snprintf(lbl, sizeof(lbl), "%02d:%02d", e.hour, e.minute);
          if (hasWater()) {
            startPump(SRC_SCHED, (unsigned long)e.durationSec * 1000UL);
            Serial.printf("[Schedule] %s triggered pump (%us)\n", lbl, (unsigned)e.durationSec);
            logEvent(String("Pump started — Schedule ") + lbl);
          } else {
            triggerBlocked(SRC_SCHED);
            logEvent(String("Pump blocked — water low (Schedule ") + lbl + ")");
          }
          break;
        }
      }
    }
  }

  delay(50);
}
